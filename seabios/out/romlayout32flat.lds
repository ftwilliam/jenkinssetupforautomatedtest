
/* DO NOT EDIT!  This is an autogenerated file.  See scripts/layoutrom.py. */
OUTPUT_FORMAT("elf32-i386")
OUTPUT_ARCH("i386")
SECTIONS
{
sercon_char = 0xef799 ;
rx_buf = 0xef788 ;
CDRom_locks = 0xef7a0 ;
sercon_row_last = 0xef79a ;
emulated_drive_gf = 0xef7b0 ;
StackPos = 0xef7d8 ;
DefaultDPTE = 0xef7c8 ;
sercon_col_last = 0xef79b ;
sercon_attr_last = 0xef79c ;
tpm_state = 0xef754 ;
Call16Data = 0xeffe4 ;
TPM_interface_shutdown = 0xef750 ;
BootSequence = 0xef768 ;
CDEmu = 0xef7b4 ;
LastUSBkey = 0xef770 ;
rx_bytes = 0xef785 ;
Century = 0xef784 ;
ExtraStack = 0xef7e0 ;
sercon_attr = 0xef798 ;
Ps2ctr = 0xef778 ;
FloppyDOR = 0xef76c ;
TPM_working = 0xef751 ;
RTCusers = 0xef77c ;
TimerLast = 0xef780 ;
sercon_port = 0xef79e ;
entry_15_official = 0xff859 ;
transition16big = 0xfcfc9 ;
entry_13_official = 0xfe3fe ;
irq_trampoline_0x16 = 0xfd09e ;
irq_trampoline_0x13 = 0xfd098 ;
entry_1a_official = 0xffe6e ;
irq_trampoline_0x10 = 0xfd095 ;
__csm_return = 0xfd2ae ;
entry_csm = 0xfd277 ;
irq_trampoline_0x19 = 0xfd0a4 ;
_cfunc16_check_irqs = 0xf93e0 ;
entry_iret_official = 0xfff53 ;
entry_09 = 0xfe987 ;
entry_08 = 0xffea5 ;
entry_pnp_real = 0xfd11e ;
entry_19_official = 0xfe6f2 ;
entry_40 = 0xfec59 ;
entry_02 = 0xfe2c3 ;
_cfunc16_call16_helper = 0xf8864 ;
entry_05 = 0xfff54 ;
entry_74 = 0xfd42c ;
irq_trampoline_0x18 = 0xfd0a1 ;
_cfunc16_wait_irq = 0xfbd2d ;
reset_vector = 0xffff0 ;
transition16 = 0xfcfb4 ;
entry_pnp_prot = 0xfd11a ;
entry_70 = 0xfd423 ;
entry_76 = 0xfd41a ;
entry_pmm = 0xfd0bc ;
entry_75 = 0xfd435 ;
entry_18 = 0xfd45a ;
entry_bios32 = 0xff046 ;
_cfunc16__farcall16 = 0xf8cb0 ;
entry_11 = 0xff84d ;
entry_12 = 0xff841 ;
entry_14 = 0xfe739 ;
entry_16 = 0xfe82e ;
entry_17 = 0xfefd2 ;
entry_10 = 0xff065 ;
transition32_nmi_off = 0xfcf7e ;
entry_hwpic1 = 0xfd43e ;
entry_hwpic2 = 0xfec4e ;
entry_0e = 0xfef57 ;

    _reloc_min_align = 0x20 ;
    zonefseg_start = 0xf0000 ;
    zonefseg_end = 0xf0aa0 ;
    zonelow_base = 0xe0000 ;
    final_varlow_start = 0xef750 ;
    final_readonly_start = 0xf0000 ;
    varlow_start = 0xe5170 ;
    varlow_end = 0xe5a20 ;
    code32init_start = 0xe5a20 ;
    code32init_end = 0xf0aa0 ;

    code32flat_start = 0xe45e0 ;
    .text code32flat_start : {

        _reloc_abs_start = ABSOLUTE(.) ;
LONG(0xe5d2d - code32init_start)
LONG(0xe5d85 - code32init_start)
LONG(0xe5d8c - code32init_start)
LONG(0xe5db8 - code32init_start)
LONG(0xe5dbf - code32init_start)
LONG(0xe5dd6 - code32init_start)
LONG(0xe5de9 - code32init_start)
LONG(0xe5e05 - code32init_start)
LONG(0xe5e7f - code32init_start)
LONG(0xe5ec8 - code32init_start)
LONG(0xe5ed1 - code32init_start)
LONG(0xe5f04 - code32init_start)
LONG(0xe5f0d - code32init_start)
LONG(0xe5f21 - code32init_start)
LONG(0xe5f32 - code32init_start)
LONG(0xe5f3d - code32init_start)
LONG(0xe608f - code32init_start)
LONG(0xe661a - code32init_start)
LONG(0xe6632 - code32init_start)
LONG(0xe6644 - code32init_start)
LONG(0xe6656 - code32init_start)
LONG(0xe6668 - code32init_start)
LONG(0xe6676 - code32init_start)
LONG(0xe6686 - code32init_start)
LONG(0xe6696 - code32init_start)
LONG(0xe6912 - code32init_start)
LONG(0xe6923 - code32init_start)
LONG(0xe6944 - code32init_start)
LONG(0xe6c6f - code32init_start)
LONG(0xe70c8 - code32init_start)
LONG(0xe70f4 - code32init_start)
LONG(0xe710f - code32init_start)
LONG(0xe716e - code32init_start)
LONG(0xe7191 - code32init_start)
LONG(0xe71a5 - code32init_start)
LONG(0xe71b6 - code32init_start)
LONG(0xe71e3 - code32init_start)
LONG(0xe7442 - code32init_start)
LONG(0xe745c - code32init_start)
LONG(0xe746b - code32init_start)
LONG(0xe7509 - code32init_start)
LONG(0xe751a - code32init_start)
LONG(0xe752b - code32init_start)
LONG(0xe7537 - code32init_start)
LONG(0xe7548 - code32init_start)
LONG(0xe757c - code32init_start)
LONG(0xe758e - code32init_start)
LONG(0xe75b0 - code32init_start)
LONG(0xe75d8 - code32init_start)
LONG(0xe7616 - code32init_start)
LONG(0xe76be - code32init_start)
LONG(0xe76ce - code32init_start)
LONG(0xe7700 - code32init_start)
LONG(0xe7785 - code32init_start)
LONG(0xe77a8 - code32init_start)
LONG(0xe77cc - code32init_start)
LONG(0xe7816 - code32init_start)
LONG(0xe7873 - code32init_start)
LONG(0xe789c - code32init_start)
LONG(0xe78a3 - code32init_start)
LONG(0xe7948 - code32init_start)
LONG(0xe797c - code32init_start)
LONG(0xe79ff - code32init_start)
LONG(0xe7a10 - code32init_start)
LONG(0xe7a71 - code32init_start)
LONG(0xe7a82 - code32init_start)
LONG(0xe7b0c - code32init_start)
LONG(0xe7b4d - code32init_start)
LONG(0xe7bbf - code32init_start)
LONG(0xe7c69 - code32init_start)
LONG(0xe7c97 - code32init_start)
LONG(0xe7d67 - code32init_start)
LONG(0xe7dd9 - code32init_start)
LONG(0xe7e77 - code32init_start)
LONG(0xe7f02 - code32init_start)
LONG(0xe7f58 - code32init_start)
LONG(0xe80ce - code32init_start)
LONG(0xe80dc - code32init_start)
LONG(0xe814a - code32init_start)
LONG(0xe81ef - code32init_start)
LONG(0xe8223 - code32init_start)
LONG(0xe8233 - code32init_start)
LONG(0xe8259 - code32init_start)
LONG(0xe82f0 - code32init_start)
LONG(0xe835b - code32init_start)
LONG(0xe83a5 - code32init_start)
LONG(0xe83b5 - code32init_start)
LONG(0xe8469 - code32init_start)
LONG(0xe84b5 - code32init_start)
LONG(0xe8556 - code32init_start)
LONG(0xe8560 - code32init_start)
LONG(0xe85d4 - code32init_start)
LONG(0xe8614 - code32init_start)
LONG(0xe86da - code32init_start)
LONG(0xe8712 - code32init_start)
LONG(0xe871c - code32init_start)
LONG(0xe872e - code32init_start)
LONG(0xe8754 - code32init_start)
LONG(0xe897b - code32init_start)
LONG(0xe89a7 - code32init_start)
LONG(0xe89ac - code32init_start)
LONG(0xe89b9 - code32init_start)
LONG(0xe89c2 - code32init_start)
LONG(0xe89d9 - code32init_start)
LONG(0xe89f1 - code32init_start)
LONG(0xe8b21 - code32init_start)
LONG(0xe8b5a - code32init_start)
LONG(0xe8d04 - code32init_start)
LONG(0xe8dc8 - code32init_start)
LONG(0xe8f6b - code32init_start)
LONG(0xe8fe9 - code32init_start)
LONG(0xe90c3 - code32init_start)
LONG(0xe90dc - code32init_start)
LONG(0xe90e4 - code32init_start)
LONG(0xe9125 - code32init_start)
LONG(0xe921c - code32init_start)
LONG(0xe92b8 - code32init_start)
LONG(0xe92da - code32init_start)
LONG(0xe9358 - code32init_start)
LONG(0xe95b2 - code32init_start)
LONG(0xe9659 - code32init_start)
LONG(0xe9669 - code32init_start)
LONG(0xe98cd - code32init_start)
LONG(0xe9aed - code32init_start)
LONG(0xe9b00 - code32init_start)
LONG(0xe9bfb - code32init_start)
LONG(0xe9d36 - code32init_start)
LONG(0xea105 - code32init_start)
LONG(0xea11d - code32init_start)
LONG(0xea136 - code32init_start)
LONG(0xea1f1 - code32init_start)
LONG(0xea5f8 - code32init_start)
LONG(0xea7cf - code32init_start)
LONG(0xeb60a - code32init_start)
LONG(0xeb656 - code32init_start)
LONG(0xeb65f - code32init_start)
LONG(0xeb691 - code32init_start)
LONG(0xebacb - code32init_start)
LONG(0xebaf4 - code32init_start)
LONG(0xebbf2 - code32init_start)
LONG(0xebd22 - code32init_start)
LONG(0xebd43 - code32init_start)
LONG(0xebfa7 - code32init_start)
LONG(0xec02b - code32init_start)
LONG(0xec16d - code32init_start)
LONG(0xec2f0 - code32init_start)
LONG(0xec4ee - code32init_start)
LONG(0xec5b6 - code32init_start)
LONG(0xec5d4 - code32init_start)
LONG(0xec606 - code32init_start)
LONG(0xec732 - code32init_start)
LONG(0xec73b - code32init_start)
LONG(0xec74b - code32init_start)
LONG(0xec7fa - code32init_start)
LONG(0xec813 - code32init_start)
LONG(0xec876 - code32init_start)
LONG(0xec9f9 - code32init_start)
LONG(0xeca29 - code32init_start)
LONG(0xecaa8 - code32init_start)
LONG(0xecac6 - code32init_start)
LONG(0xecaee - code32init_start)
LONG(0xecb4e - code32init_start)
LONG(0xecbb2 - code32init_start)
LONG(0xecc0d - code32init_start)
LONG(0xecc87 - code32init_start)
LONG(0xece1b - code32init_start)
LONG(0xece5b - code32init_start)
LONG(0xed1e0 - code32init_start)
LONG(0xed21b - code32init_start)
LONG(0xed23c - code32init_start)
LONG(0xed290 - code32init_start)
LONG(0xed2e4 - code32init_start)
LONG(0xed30c - code32init_start)
LONG(0xed31b - code32init_start)
LONG(0xed3ae - code32init_start)
LONG(0xed412 - code32init_start)
LONG(0xed417 - code32init_start)
LONG(0xed466 - code32init_start)
LONG(0xed609 - code32init_start)
LONG(0xed61e - code32init_start)
LONG(0xed66c - code32init_start)
LONG(0xed6b1 - code32init_start)
LONG(0xed6cb - code32init_start)
LONG(0xed6e3 - code32init_start)
LONG(0xed734 - code32init_start)
LONG(0xed7b0 - code32init_start)
LONG(0xed7c8 - code32init_start)
LONG(0xed80f - code32init_start)
LONG(0xed85f - code32init_start)
LONG(0xed8b5 - code32init_start)
LONG(0xed946 - code32init_start)
LONG(0xed94b - code32init_start)
LONG(0xed958 - code32init_start)
LONG(0xed9d3 - code32init_start)
LONG(0xeda2d - code32init_start)
LONG(0xedac0 - code32init_start)
LONG(0xedb1b - code32init_start)
LONG(0xedba1 - code32init_start)
LONG(0xedbd8 - code32init_start)
LONG(0xedc11 - code32init_start)
LONG(0xedc2e - code32init_start)
LONG(0xedc6b - code32init_start)
LONG(0xedc7f - code32init_start)
LONG(0xedc8e - code32init_start)
LONG(0xedcef - code32init_start)
LONG(0xedd01 - code32init_start)
LONG(0xedd1e - code32init_start)
LONG(0xee00a - code32init_start)
LONG(0xee21c - code32init_start)
LONG(0xee2ed - code32init_start)
LONG(0xee328 - code32init_start)
LONG(0xee4ff - code32init_start)
LONG(0xee858 - code32init_start)
LONG(0xeebe1 - code32init_start)
LONG(0xeec77 - code32init_start)
LONG(0xeef8c - code32init_start)
LONG(0xef057 - code32init_start)
LONG(0xef0a2 - code32init_start)
LONG(0xef0b3 - code32init_start)
LONG(0xef3b3 - code32init_start)
LONG(0xef4ff - code32init_start)
LONG(0xef626 - code32init_start)
LONG(0xef7ba - code32init_start)
LONG(0xefa3d - code32init_start)
LONG(0xefb05 - code32init_start)
LONG(0xefe16 - code32init_start)
LONG(0xefe1b - code32init_start)
LONG(0xefe22 - code32init_start)
LONG(0xefe27 - code32init_start)
LONG(0xeff17 - code32init_start)
LONG(0xeff6d - code32init_start)
LONG(0xeff8b - code32init_start)
LONG(0xeff9d - code32init_start)
LONG(0xeffc4 - code32init_start)
LONG(0xeffd2 - code32init_start)
LONG(0xeffdb - code32init_start)
LONG(0xeffec - code32init_start)
LONG(0xefff8 - code32init_start)
LONG(0xf000f - code32init_start)
LONG(0xf005d - code32init_start)
LONG(0xf0146 - code32init_start)
LONG(0xf0157 - code32init_start)
LONG(0xf01ae - code32init_start)
LONG(0xf01d4 - code32init_start)
LONG(0xf02ac - code32init_start)
LONG(0xf02c2 - code32init_start)
LONG(0xf02f8 - code32init_start)
LONG(0xf02fc - code32init_start)
LONG(0xf0300 - code32init_start)
LONG(0xf0304 - code32init_start)
LONG(0xf0308 - code32init_start)
LONG(0xf030c - code32init_start)
LONG(0xf0310 - code32init_start)
LONG(0xf0314 - code32init_start)
LONG(0xf0318 - code32init_start)
LONG(0xf031c - code32init_start)
LONG(0xf0320 - code32init_start)
LONG(0xf0324 - code32init_start)
LONG(0xf0328 - code32init_start)
LONG(0xf032c - code32init_start)
LONG(0xf0330 - code32init_start)
LONG(0xf0334 - code32init_start)
LONG(0xf0930 - code32init_start)
LONG(0xf0944 - code32init_start)
LONG(0xf0970 - code32init_start)
LONG(0xf0974 - code32init_start)
LONG(0xf097c - code32init_start)
LONG(0xf0980 - code32init_start)
LONG(0xf0984 - code32init_start)
LONG(0xf0988 - code32init_start)
LONG(0xf098c - code32init_start)
LONG(0xf09f0 - code32init_start)
LONG(0xf09f4 - code32init_start)
LONG(0xf09f8 - code32init_start)
LONG(0xf09fc - code32init_start)
LONG(0xf0a00 - code32init_start)
LONG(0xf0a18 - code32init_start)
LONG(0xf0a1c - code32init_start)
LONG(0xf0a24 - code32init_start)
LONG(0xf0a28 - code32init_start)
LONG(0xf0a2c - code32init_start)
LONG(0xf0a34 - code32init_start)
LONG(0xf0a38 - code32init_start)
LONG(0xf0a3c - code32init_start)
LONG(0xf0a44 - code32init_start)
        _reloc_abs_end = ABSOLUTE(.) ;
        _reloc_rel_start = ABSOLUTE(.) ;
LONG(0xe5a92 - code32init_start)
LONG(0xe5e77 - code32init_start)
LONG(0xe6096 - code32init_start)
LONG(0xe6a3c - code32init_start)
LONG(0xe6a4f - code32init_start)
LONG(0xe6a68 - code32init_start)
LONG(0xe6a80 - code32init_start)
LONG(0xe6ace - code32init_start)
LONG(0xe6b3d - code32init_start)
LONG(0xe6c3d - code32init_start)
LONG(0xe6c66 - code32init_start)
LONG(0xe6cfd - code32init_start)
LONG(0xe6d0d - code32init_start)
LONG(0xe6d24 - code32init_start)
LONG(0xe6d41 - code32init_start)
LONG(0xe6d50 - code32init_start)
LONG(0xe6d55 - code32init_start)
LONG(0xe6d79 - code32init_start)
LONG(0xe6da5 - code32init_start)
LONG(0xe6dae - code32init_start)
LONG(0xe6db7 - code32init_start)
LONG(0xe6eac - code32init_start)
LONG(0xe6ebf - code32init_start)
LONG(0xe6ec8 - code32init_start)
LONG(0xe6fb5 - code32init_start)
LONG(0xe7000 - code32init_start)
LONG(0xe701a - code32init_start)
LONG(0xe7031 - code32init_start)
LONG(0xe7048 - code32init_start)
LONG(0xe705a - code32init_start)
LONG(0xe7083 - code32init_start)
LONG(0xe709f - code32init_start)
LONG(0xe70d2 - code32init_start)
LONG(0xe7119 - code32init_start)
LONG(0xe715e - code32init_start)
LONG(0xe7179 - code32init_start)
LONG(0xe719b - code32init_start)
LONG(0xe71f3 - code32init_start)
LONG(0xe7475 - code32init_start)
LONG(0xe756a - code32init_start)
LONG(0xe76d8 - code32init_start)
LONG(0xe76e6 - code32init_start)
LONG(0xe778a - code32init_start)
LONG(0xe77b2 - code32init_start)
LONG(0xe77c0 - code32init_start)
LONG(0xe77df - code32init_start)
LONG(0xe7820 - code32init_start)
LONG(0xe7882 - code32init_start)
LONG(0xe7952 - code32init_start)
LONG(0xe7986 - code32init_start)
LONG(0xe7994 - code32init_start)
LONG(0xe79da - code32init_start)
LONG(0xe7a1a - code32init_start)
LONG(0xe7a4c - code32init_start)
LONG(0xe7a8c - code32init_start)
LONG(0xe7ab4 - code32init_start)
LONG(0xe7ace - code32init_start)
LONG(0xe7b01 - code32init_start)
LONG(0xe7b16 - code32init_start)
LONG(0xe7b43 - code32init_start)
LONG(0xe7b57 - code32init_start)
LONG(0xe7bc9 - code32init_start)
LONG(0xe7bdc - code32init_start)
LONG(0xe7bf8 - code32init_start)
LONG(0xe7c12 - code32init_start)
LONG(0xe7c71 - code32init_start)
LONG(0xe7c83 - code32init_start)
LONG(0xe7cd2 - code32init_start)
LONG(0xe7d44 - code32init_start)
LONG(0xe7d5e - code32init_start)
LONG(0xe7d71 - code32init_start)
LONG(0xe7d89 - code32init_start)
LONG(0xe7de3 - code32init_start)
LONG(0xe7df6 - code32init_start)
LONG(0xe7e04 - code32init_start)
LONG(0xe7e51 - code32init_start)
LONG(0xe7e6e - code32init_start)
LONG(0xe7e81 - code32init_start)
LONG(0xe7f0a - code32init_start)
LONG(0xe7f42 - code32init_start)
LONG(0xe7f89 - code32init_start)
LONG(0xe8020 - code32init_start)
LONG(0xe8030 - code32init_start)
LONG(0xe805d - code32init_start)
LONG(0xe8082 - code32init_start)
LONG(0xe8090 - code32init_start)
LONG(0xe80a4 - code32init_start)
LONG(0xe80d3 - code32init_start)
LONG(0xe80e6 - code32init_start)
LONG(0xe80f0 - code32init_start)
LONG(0xe8110 - code32init_start)
LONG(0xe8120 - code32init_start)
LONG(0xe8139 - code32init_start)
LONG(0xe8140 - code32init_start)
LONG(0xe8154 - code32init_start)
LONG(0xe815b - code32init_start)
LONG(0xe816d - code32init_start)
LONG(0xe817b - code32init_start)
LONG(0xe818f - code32init_start)
LONG(0xe81d5 - code32init_start)
LONG(0xe81e6 - code32init_start)
LONG(0xe81f9 - code32init_start)
LONG(0xe8203 - code32init_start)
LONG(0xe823d - code32init_start)
LONG(0xe8250 - code32init_start)
LONG(0xe8263 - code32init_start)
LONG(0xe8277 - code32init_start)
LONG(0xe8280 - code32init_start)
LONG(0xe82c5 - code32init_start)
LONG(0xe82db - code32init_start)
LONG(0xe82e7 - code32init_start)
LONG(0xe82fa - code32init_start)
LONG(0xe8365 - code32init_start)
LONG(0xe8381 - code32init_start)
LONG(0xe839c - code32init_start)
LONG(0xe83af - code32init_start)
LONG(0xe83bf - code32init_start)
LONG(0xe83d9 - code32init_start)
LONG(0xe8422 - code32init_start)
LONG(0xe84a2 - code32init_start)
LONG(0xe84eb - code32init_start)
LONG(0xe8551 - code32init_start)
LONG(0xe85fa - code32init_start)
LONG(0xe861e - code32init_start)
LONG(0xe865a - code32init_start)
LONG(0xe86be - code32init_start)
LONG(0xe8745 - code32init_start)
LONG(0xe88f8 - code32init_start)
LONG(0xe891b - code32init_start)
LONG(0xe89cc - code32init_start)
LONG(0xe89e9 - code32init_start)
LONG(0xe8a25 - code32init_start)
LONG(0xe8a45 - code32init_start)
LONG(0xe8a6e - code32init_start)
LONG(0xe8a99 - code32init_start)
LONG(0xe8af0 - code32init_start)
LONG(0xe8b64 - code32init_start)
LONG(0xe8b75 - code32init_start)
LONG(0xe8c90 - code32init_start)
LONG(0xe8ce9 - code32init_start)
LONG(0xe8d0e - code32init_start)
LONG(0xe8d1c - code32init_start)
LONG(0xe8dd2 - code32init_start)
LONG(0xe8dea - code32init_start)
LONG(0xe8df9 - code32init_start)
LONG(0xe8e08 - code32init_start)
LONG(0xe8e17 - code32init_start)
LONG(0xe8f75 - code32init_start)
LONG(0xe8fd6 - code32init_start)
LONG(0xe9003 - code32init_start)
LONG(0xe907b - code32init_start)
LONG(0xe908d - code32init_start)
LONG(0xe90d4 - code32init_start)
LONG(0xe911e - code32init_start)
LONG(0xe9251 - code32init_start)
LONG(0xe9295 - code32init_start)
LONG(0xe92af - code32init_start)
LONG(0xe92c2 - code32init_start)
LONG(0xe92c9 - code32init_start)
LONG(0xe92fd - code32init_start)
LONG(0xe932d - code32init_start)
LONG(0xe9345 - code32init_start)
LONG(0xe934f - code32init_start)
LONG(0xe9362 - code32init_start)
LONG(0xe936c - code32init_start)
LONG(0xe9382 - code32init_start)
LONG(0xe93e4 - code32init_start)
LONG(0xe956e - code32init_start)
LONG(0xe958a - code32init_start)
LONG(0xe95a5 - code32init_start)
LONG(0xe95bc - code32init_start)
LONG(0xe95c3 - code32init_start)
LONG(0xe961e - code32init_start)
LONG(0xe9634 - code32init_start)
LONG(0xe9644 - code32init_start)
LONG(0xe9663 - code32init_start)
LONG(0xe9795 - code32init_start)
LONG(0xe97f8 - code32init_start)
LONG(0xe980f - code32init_start)
LONG(0xe981e - code32init_start)
LONG(0xe9871 - code32init_start)
LONG(0xe9888 - code32init_start)
LONG(0xe98aa - code32init_start)
LONG(0xe98e6 - code32init_start)
LONG(0xe9af7 - code32init_start)
LONG(0xe9b1a - code32init_start)
LONG(0xe9b4d - code32init_start)
LONG(0xe9ba5 - code32init_start)
LONG(0xe9c05 - code32init_start)
LONG(0xe9c16 - code32init_start)
LONG(0xe9c57 - code32init_start)
LONG(0xe9c88 - code32init_start)
LONG(0xe9ccd - code32init_start)
LONG(0xe9ce8 - code32init_start)
LONG(0xe9d09 - code32init_start)
LONG(0xe9d2d - code32init_start)
LONG(0xe9d40 - code32init_start)
LONG(0xe9d72 - code32init_start)
LONG(0xe9da8 - code32init_start)
LONG(0xe9dd7 - code32init_start)
LONG(0xe9e31 - code32init_start)
LONG(0xe9ec3 - code32init_start)
LONG(0xe9f83 - code32init_start)
LONG(0xea00e - code32init_start)
LONG(0xea092 - code32init_start)
LONG(0xea140 - code32init_start)
LONG(0xea152 - code32init_start)
LONG(0xea16f - code32init_start)
LONG(0xea1b9 - code32init_start)
LONG(0xea1fb - code32init_start)
LONG(0xea5d2 - code32init_start)
LONG(0xea602 - code32init_start)
LONG(0xea676 - code32init_start)
LONG(0xea6c6 - code32init_start)
LONG(0xea6d9 - code32init_start)
LONG(0xea6f4 - code32init_start)
LONG(0xea743 - code32init_start)
LONG(0xea7d9 - code32init_start)
LONG(0xea8e6 - code32init_start)
LONG(0xeb59e - code32init_start)
LONG(0xeb5b5 - code32init_start)
LONG(0xeb5f0 - code32init_start)
LONG(0xeb687 - code32init_start)
LONG(0xeb6bd - code32init_start)
LONG(0xeb6db - code32init_start)
LONG(0xeb6f5 - code32init_start)
LONG(0xeb745 - code32init_start)
LONG(0xeb776 - code32init_start)
LONG(0xeb791 - code32init_start)
LONG(0xeb80a - code32init_start)
LONG(0xeb814 - code32init_start)
LONG(0xeb822 - code32init_start)
LONG(0xeb83b - code32init_start)
LONG(0xeb855 - code32init_start)
LONG(0xeb86f - code32init_start)
LONG(0xeb884 - code32init_start)
LONG(0xeb88f - code32init_start)
LONG(0xeb8a4 - code32init_start)
LONG(0xeb8c5 - code32init_start)
LONG(0xeb8e4 - code32init_start)
LONG(0xeb906 - code32init_start)
LONG(0xeb928 - code32init_start)
LONG(0xeb963 - code32init_start)
LONG(0xeb9da - code32init_start)
LONG(0xeba6a - code32init_start)
LONG(0xeba96 - code32init_start)
LONG(0xebabb - code32init_start)
LONG(0xebb28 - code32init_start)
LONG(0xebb4c - code32init_start)
LONG(0xebb66 - code32init_start)
LONG(0xebb86 - code32init_start)
LONG(0xebc98 - code32init_start)
LONG(0xebcea - code32init_start)
LONG(0xebd97 - code32init_start)
LONG(0xebdac - code32init_start)
LONG(0xebe46 - code32init_start)
LONG(0xebea9 - code32init_start)
LONG(0xebf46 - code32init_start)
LONG(0xebf6e - code32init_start)
LONG(0xebf9e - code32init_start)
LONG(0xebfb1 - code32init_start)
LONG(0xebfe6 - code32init_start)
LONG(0xec054 - code32init_start)
LONG(0xec06c - code32init_start)
LONG(0xec177 - code32init_start)
LONG(0xec1a3 - code32init_start)
LONG(0xec306 - code32init_start)
LONG(0xec409 - code32init_start)
LONG(0xec4f8 - code32init_start)
LONG(0xec514 - code32init_start)
LONG(0xec610 - code32init_start)
LONG(0xec633 - code32init_start)
LONG(0xec640 - code32init_start)
LONG(0xec64d - code32init_start)
LONG(0xec761 - code32init_start)
LONG(0xec82c - code32init_start)
LONG(0xec880 - code32init_start)
LONG(0xec891 - code32init_start)
LONG(0xeca33 - code32init_start)
LONG(0xeca6d - code32init_start)
LONG(0xecab2 - code32init_start)
LONG(0xecad0 - code32init_start)
LONG(0xecaf8 - code32init_start)
LONG(0xecbbc - code32init_start)
LONG(0xecc17 - code32init_start)
LONG(0xecc2f - code32init_start)
LONG(0xecca3 - code32init_start)
LONG(0xeccfc - code32init_start)
LONG(0xecd4e - code32init_start)
LONG(0xecdea - code32init_start)
LONG(0xece03 - code32init_start)
LONG(0xece12 - code32init_start)
LONG(0xece2b - code32init_start)
LONG(0xecea3 - code32init_start)
LONG(0xed0d6 - code32init_start)
LONG(0xed19f - code32init_start)
LONG(0xed246 - code32init_start)
LONG(0xed259 - code32init_start)
LONG(0xed29b - code32init_start)
LONG(0xed2ff - code32init_start)
LONG(0xed316 - code32init_start)
LONG(0xed359 - code32init_start)
LONG(0xed370 - code32init_start)
LONG(0xed3c5 - code32init_start)
LONG(0xed3e7 - code32init_start)
LONG(0xed470 - code32init_start)
LONG(0xed481 - code32init_start)
LONG(0xed504 - code32init_start)
LONG(0xed580 - code32init_start)
LONG(0xed5c1 - code32init_start)
LONG(0xed5f0 - code32init_start)
LONG(0xed676 - code32init_start)
LONG(0xed684 - code32init_start)
LONG(0xed6bd - code32init_start)
LONG(0xed73e - code32init_start)
LONG(0xed74c - code32init_start)
LONG(0xed763 - code32init_start)
LONG(0xed79b - code32init_start)
LONG(0xed819 - code32init_start)
LONG(0xed827 - code32init_start)
LONG(0xed83d - code32init_start)
LONG(0xed941 - code32init_start)
LONG(0xeda37 - code32init_start)
LONG(0xeda6b - code32init_start)
LONG(0xedb25 - code32init_start)
LONG(0xedb33 - code32init_start)
LONG(0xedb42 - code32init_start)
LONG(0xedb51 - code32init_start)
LONG(0xedb5f - code32init_start)
LONG(0xedb70 - code32init_start)
LONG(0xedb88 - code32init_start)
LONG(0xedb98 - code32init_start)
LONG(0xedc89 - code32init_start)
LONG(0xedd9b - code32init_start)
LONG(0xeddf9 - code32init_start)
LONG(0xede64 - code32init_start)
LONG(0xedfbe - code32init_start)
LONG(0xee01b - code32init_start)
LONG(0xee027 - code32init_start)
LONG(0xee152 - code32init_start)
LONG(0xee175 - code32init_start)
LONG(0xee17f - code32init_start)
LONG(0xee1d4 - code32init_start)
LONG(0xee1f3 - code32init_start)
LONG(0xee1fd - code32init_start)
LONG(0xee226 - code32init_start)
LONG(0xee256 - code32init_start)
LONG(0xee2f7 - code32init_start)
LONG(0xee3dc - code32init_start)
LONG(0xee418 - code32init_start)
LONG(0xee497 - code32init_start)
LONG(0xee4ae - code32init_start)
LONG(0xee4cb - code32init_start)
LONG(0xee4da - code32init_start)
LONG(0xee4e1 - code32init_start)
LONG(0xee4f6 - code32init_start)
LONG(0xee509 - code32init_start)
LONG(0xee52b - code32init_start)
LONG(0xee5e0 - code32init_start)
LONG(0xee620 - code32init_start)
LONG(0xee72a - code32init_start)
LONG(0xee7a1 - code32init_start)
LONG(0xee7b6 - code32init_start)
LONG(0xee7cc - code32init_start)
LONG(0xee7d6 - code32init_start)
LONG(0xee7e8 - code32init_start)
LONG(0xee7f7 - code32init_start)
LONG(0xee800 - code32init_start)
LONG(0xee810 - code32init_start)
LONG(0xee823 - code32init_start)
LONG(0xee82e - code32init_start)
LONG(0xee840 - code32init_start)
LONG(0xee84f - code32init_start)
LONG(0xee862 - code32init_start)
LONG(0xee870 - code32init_start)
LONG(0xee880 - code32init_start)
LONG(0xee897 - code32init_start)
LONG(0xee8a8 - code32init_start)
LONG(0xee8c1 - code32init_start)
LONG(0xee8e9 - code32init_start)
LONG(0xee8fe - code32init_start)
LONG(0xeea78 - code32init_start)
LONG(0xeea9a - code32init_start)
LONG(0xeeabd - code32init_start)
LONG(0xeeae3 - code32init_start)
LONG(0xeeafa - code32init_start)
LONG(0xeeb15 - code32init_start)
LONG(0xeeb2e - code32init_start)
LONG(0xeeb63 - code32init_start)
LONG(0xeebeb - code32init_start)
LONG(0xeec81 - code32init_start)
LONG(0xeecb2 - code32init_start)
LONG(0xeecc5 - code32init_start)
LONG(0xeecd5 - code32init_start)
LONG(0xeeceb - code32init_start)
LONG(0xeecfb - code32init_start)
LONG(0xeed2e - code32init_start)
LONG(0xeed4c - code32init_start)
LONG(0xeed62 - code32init_start)
LONG(0xeed8e - code32init_start)
LONG(0xeee1d - code32init_start)
LONG(0xeee87 - code32init_start)
LONG(0xeee98 - code32init_start)
LONG(0xeeeb1 - code32init_start)
LONG(0xeeed8 - code32init_start)
LONG(0xeeee7 - code32init_start)
LONG(0xeef00 - code32init_start)
LONG(0xeef11 - code32init_start)
LONG(0xeef33 - code32init_start)
LONG(0xeef96 - code32init_start)
LONG(0xeefb2 - code32init_start)
LONG(0xeefc0 - code32init_start)
LONG(0xeeffb - code32init_start)
LONG(0xef061 - code32init_start)
LONG(0xef072 - code32init_start)
LONG(0xef0bd - code32init_start)
LONG(0xef1a5 - code32init_start)
LONG(0xef21e - code32init_start)
LONG(0xef2a9 - code32init_start)
LONG(0xef2b6 - code32init_start)
LONG(0xef2bf - code32init_start)
LONG(0xef2fc - code32init_start)
LONG(0xef34c - code32init_start)
LONG(0xef509 - code32init_start)
LONG(0xef5ff - code32init_start)
LONG(0xef6ad - code32init_start)
LONG(0xef6f4 - code32init_start)
LONG(0xef7c4 - code32init_start)
LONG(0xef7d2 - code32init_start)
LONG(0xef818 - code32init_start)
LONG(0xef859 - code32init_start)
LONG(0xef8a3 - code32init_start)
LONG(0xef98a - code32init_start)
LONG(0xefa47 - code32init_start)
LONG(0xefa56 - code32init_start)
LONG(0xefa63 - code32init_start)
LONG(0xefa76 - code32init_start)
LONG(0xefb0f - code32init_start)
LONG(0xefb55 - code32init_start)
LONG(0xefbe9 - code32init_start)
LONG(0xefc46 - code32init_start)
LONG(0xefd38 - code32init_start)
LONG(0xefdd1 - code32init_start)
LONG(0xf00cd - code32init_start)
LONG(0xf00eb - code32init_start)
LONG(0xf016e - code32init_start)
LONG(0xf0198 - code32init_start)
LONG(0xf01b8 - code32init_start)
LONG(0xf01c6 - code32init_start)
LONG(0xf0225 - code32init_start)
LONG(0xf0268 - code32init_start)
        _reloc_rel_end = ABSOLUTE(.) ;
        _reloc_init_start = ABSOLUTE(.) ;
LONG(0xfc9da - code32flat_start)
LONG(0xfd0e1 - code32flat_start)
LONG(0xfd2a7 - code32flat_start)
        _reloc_init_end = ABSOLUTE(.) ;

. = ( 0xe5170 - code32flat_start ) ;
*32flat.*(.data.varlow../src/tcgbios.c.1173)
. = ( 0xe5171 - code32flat_start ) ;
*32flat.*(.data.varlow../src/tcgbios.c.720)
. = ( 0xe5174 - code32flat_start ) ;
*32flat.*(.data.varlow../src/tcgbios.c.49)
. = ( 0xe5188 - code32flat_start ) ;
*32flat.*(.data.varlow../src/boot.c.764)
. = ( 0xe518c - code32flat_start ) ;
*32flat.*(.data.varlow../src/hw/floppy.c.194)
. = ( 0xe5190 - code32flat_start ) ;
*32flat.*(.data.varlow../src/hw/usb-hid.c.235)
. = ( 0xe5198 - code32flat_start ) ;
*32flat.*(.data.varlow../src/hw/ps2port.c.211)
. = ( 0xe519c - code32flat_start ) ;
*32flat.*(.data.varlow../src/hw/rtc.c.74)
. = ( 0xe51a0 - code32flat_start ) ;
*32flat.*(.data.varlow../src/hw/timer.c.131)
. = ( 0xe51a4 - code32flat_start ) ;
*32flat.*(.data.varlow../src/clock.c.30)
. = ( 0xe51a5 - code32flat_start ) ;
*32flat.*(.data.varlow../src/sercon.c.552)
. = ( 0xe51a8 - code32flat_start ) ;
*32flat.*(.data.varlow../src/sercon.c.551)
. = ( 0xe51b8 - code32flat_start ) ;
*32flat.*(.data.varlow../src/sercon.c.68)
. = ( 0xe51b9 - code32flat_start ) ;
*32flat.*(.data.varlow../src/sercon.c.67)
. = ( 0xe51ba - code32flat_start ) ;
*32flat.*(.data.varlow../src/sercon.c.66)
. = ( 0xe51bb - code32flat_start ) ;
*32flat.*(.data.varlow../src/sercon.c.65)
. = ( 0xe51bc - code32flat_start ) ;
*32flat.*(.data.varlow../src/sercon.c.64)
. = ( 0xe51be - code32flat_start ) ;
*32flat.*(.data.varlow../src/sercon.c.49)
. = ( 0xe51c0 - code32flat_start ) ;
*32flat.*(.data.varlow../src/disk.c.439)
. = ( 0xe51d0 - code32flat_start ) ;
*32flat.*(.data.varlow../src/cdrom.c.26)
. = ( 0xe51d4 - code32flat_start ) ;
*32flat.*(.data.varlow../src/cdrom.c.25)
. = ( 0xe51e8 - code32flat_start ) ;
*32flat.*(.data.varlow../src/block.c.403)
. = ( 0xe51f8 - code32flat_start ) ;
*32flat.*(.data.varlow../src/stacks.c.327)
. = ( 0xe5200 - code32flat_start ) ;
*32flat.*(.data.varlow../src/stacks.c.326)
. = ( 0xe5a04 - code32flat_start ) ;
*32flat.*(.data.varlow../src/stacks.c.33)
. = ( 0xe5a20 - code32flat_start ) ;
*32flat.*(.text.hlist_del)
. = ( 0xe5a2f - code32flat_start ) ;
*32flat.*(.text.hlist_add)
. = ( 0xe5a40 - code32flat_start ) ;
*32flat.*(.text.putc_str)
. = ( 0xe5a4e - code32flat_start ) ;
*32flat.*(.text.memcmp)
. = ( 0xe5a6e - code32flat_start ) ;
*32flat.*(.text.strtcpy)
. = ( 0xe5a8f - code32flat_start ) ;
*32flat.*(.text.nullTrailingSpace)
. = ( 0xe5abb - code32flat_start ) ;
*32flat.*(.text.pci_config_readl)
. = ( 0xe5ad6 - code32flat_start ) ;
*32flat.*(.text.usb_add_freelist)
. = ( 0xe5ae3 - code32flat_start ) ;
*32flat.*(.text.usb_get_freelist)
. = ( 0xe5b02 - code32flat_start ) ;
*32flat.*(.text.usb_desc2pipe)
. = ( 0xe5b38 - code32flat_start ) ;
*32flat.*(.text.usb_find_desc)
. = ( 0xe5b77 - code32flat_start ) ;
*32flat.*(.text.uhci_hub_disconnect)
. = ( 0xe5b86 - code32flat_start ) ;
*32flat.*(.text.ohci_hub_detect)
. = ( 0xe5b97 - code32flat_start ) ;
*32flat.*(.text.ohci_hub_disconnect)
. = ( 0xe5ba9 - code32flat_start ) ;
*32flat.*(.text.ohci_desc2pipe)
. = ( 0xe5bf2 - code32flat_start ) ;
*32flat.*(.text.ehci_hub_disconnect)
. = ( 0xe5c05 - code32flat_start ) ;
*32flat.*(.text.ehci_desc2pipe)
. = ( 0xe5ca8 - code32flat_start ) ;
*32flat.*(.text.ata_extract_version)
. = ( 0xe5cc2 - code32flat_start ) ;
*32flat.*(.text.found_compatibleahci)
. = ( 0xe5cc3 - code32flat_start ) ;
*32flat.*(.text.alloc_new)
. = ( 0xe5d0f - code32flat_start ) ;
*32flat.*(.text.alloc_free)
. = ( 0xe5d28 - code32flat_start ) ;
*32flat.*(.text.alloc_find)
. = ( 0xe5d47 - code32flat_start ) ;
*32flat.*(.text.malloc_pfree)
. = ( 0xe5d7c - code32flat_start ) ;
*32flat.*(.text.malloc_getspace)
. = ( 0xe5dd5 - code32flat_start ) ;
*32flat.*(.text.rom_get_max)
. = ( 0xe5de6 - code32flat_start ) ;
*32flat.*(.text.rom_reserve)
. = ( 0xe5e22 - code32flat_start ) ;
*32flat.*(.text.calcRamSize)
. = ( 0xe5e6f - code32flat_start ) ;
*32flat.*(.text.romfile_findprefix)
. = ( 0xe5ea7 - code32flat_start ) ;
*32flat.*(.text.usb_portmap)
. = ( 0xe5ec0 - code32flat_start ) ;
*32flat.*(.text.add_bev)
. = ( 0xe5f15 - code32flat_start ) ;
*32flat.*(.text.unlikely.idctqtab)
. = ( 0xe5f6b - code32flat_start ) ;
*32flat.*(.text.xhci_hub_detect)
. = ( 0xe5f7a - code32flat_start ) ;
*32flat.*(.text.xhci_hub_portmap)
. = ( 0xe5fb7 - code32flat_start ) ;
*32flat.*(.text.xhci_hub_disconnect)
. = ( 0xe5fb8 - code32flat_start ) ;
*32flat.*(.text.smbios_next)
. = ( 0xe6014 - code32flat_start ) ;
*32flat.*(.text.memmove)
. = ( 0xe603b - code32flat_start ) ;
*32flat.*(.text.remove_e820)
. = ( 0xe6068 - code32flat_start ) ;
*32flat.*(.text.csm_return)
. = ( 0xe609a - code32flat_start ) ;
*32flat.*(.text.usb_get_period.isra.19)
. = ( 0xe60ba - code32flat_start ) ;
*32flat.*(.text.getword.isra.29)
. = ( 0xe60d5 - code32flat_start ) ;
*32flat.*(.text.readtables)
. = ( 0xe6457 - code32flat_start ) ;
*32flat.*(.text.fillbits)
. = ( 0xe64d3 - code32flat_start ) ;
*32flat.*(.text.dec_rec2)
. = ( 0xe65e2 - code32flat_start ) ;
*32flat.*(.text.idct)
. = ( 0xe68ef - code32flat_start ) ;
*32flat.*(.text.tpm_can_show_menu)
. = ( 0xe6921 - code32flat_start ) ;
*32flat.*(.text.csm_bootprio_ata.isra.39)
. = ( 0xe6942 - code32flat_start ) ;
*32flat.*(.text.csm_bootprio_pci.isra.43)
. = ( 0xe6997 - code32flat_start ) ;
*32flat.*(.text.ata_extract_model.constprop.124)
. = ( 0xe69bc - code32flat_start ) ;
*32flat.*(.text.detect_serial.constprop.136)
. = ( 0xe6a00 - code32flat_start ) ;
*32flat.*(.text.pic_irqmask_mask.constprop.168)
. = ( 0xe6a19 - code32flat_start ) ;
*32flat.*(.text.tpm12_get_capability)
. = ( 0xe6a8d - code32flat_start ) ;
*32flat.*(.text.tpm12_read_has_owner)
. = ( 0xe6abe - code32flat_start ) ;
*32flat.*(.text.tpm12_read_permanent_flags.constprop.172)
. = ( 0xe6b05 - code32flat_start ) ;
*32flat.*(.text.tpm12_enable_tpm.isra.105)
. = ( 0xe6b51 - code32flat_start ) ;
*32flat.*(.text.pci_config_maskw.constprop.146)
. = ( 0xe6b8a - code32flat_start ) ;
*32flat.*(.text.mathcp_setup)
. = ( 0xe6bb1 - code32flat_start ) ;
*32flat.*(.text.pci_next)
. = ( 0xe6c25 - code32flat_start ) ;
*32flat.*(.text.uhci_hub_reset)
. = ( 0xe6c60 - code32flat_start ) ;
*32flat.*(.text.romfile_find)
. = ( 0xe6c91 - code32flat_start ) ;
*32flat.*(.text.romfile_loadint)
. = ( 0xe6cf0 - code32flat_start ) ;
*32flat.*(.text.wait_threads)
. = ( 0xe6d04 - code32flat_start ) ;
*32flat.*(.text.mutex_lock)
. = ( 0xe6d1b - code32flat_start ) ;
*32flat.*(.text.call16_int10)
. = ( 0xe6d59 - code32flat_start ) ;
*32flat.*(.text.wait_preempt)
. = ( 0xe6d85 - code32flat_start ) ;
*32flat.*(.text.pci_enable_busmaster)
. = ( 0xe6da3 - code32flat_start ) ;
*32flat.*(.text.msleep)
. = ( 0xe6dbf - code32flat_start ) ;
*32flat.*(.text.uhci_hub_detect)
. = ( 0xe6de9 - code32flat_start ) ;
*32flat.*(.text.ehci_hub_reset)
. = ( 0xe6e23 - code32flat_start ) ;
*32flat.*(.text.ehci_hub_detect)
. = ( 0xe6e6b - code32flat_start ) ;
*32flat.*(.text.clock_setup)
. = ( 0xe6faa - code32flat_start ) ;
*32flat.*(.text.iomemcpy)
. = ( 0xe6fee - code32flat_start ) ;
*32flat.*(.text.get_keystroke)
. = ( 0xe7092 - code32flat_start ) ;
*32flat.*(.text.thread_setup)
. = ( 0xe70ba - code32flat_start ) ;
*32flat.*(.text.free)
. = ( 0xe70d7 - code32flat_start ) ;
*32flat.*(.text.pci_enable_iobar)
. = ( 0xe713b - code32flat_start ) ;
*32flat.*(.text.__end_thread)
. = ( 0xe7164 - code32flat_start ) ;
*32flat.*(.text.add_drive)
. = ( 0xe7184 - code32flat_start ) ;
*32flat.*(.text.rom_confirm)
. = ( 0xe71be - code32flat_start ) ;
*32flat.*(.text.insert_e820)
. = ( 0xe7256 - code32flat_start ) ;
*32flat.*(.text.e820_add.part.81)
. = ( 0xe7431 - code32flat_start ) ;
*32flat.*(.text.alloc_new_detail)
. = ( 0xe74bb - code32flat_start ) ;
*32flat.*(.text.malloc_palloc.part.83)
. = ( 0xe74f5 - code32flat_start ) ;
*32flat.*(.text.malloc_palloc)
. = ( 0xe7501 - code32flat_start ) ;
*32flat.*(.text.malloc_tmphigh)
. = ( 0xe7512 - code32flat_start ) ;
*32flat.*(.text.malloc_low)
. = ( 0xe7523 - code32flat_start ) ;
*32flat.*(.text.malloc_fseg)
. = ( 0xe7534 - code32flat_start ) ;
*32flat.*(.text.memalign_high)
. = ( 0xe7540 - code32flat_start ) ;
*32flat.*(.text.malloc_high)
. = ( 0xe7551 - code32flat_start ) ;
*32flat.*(.text.zalloc_page_aligned)
. = ( 0xe7573 - code32flat_start ) ;
*32flat.*(.text.memalign_tmp)
. = ( 0xe759c - code32flat_start ) ;
*32flat.*(.text.malloc_tmp)
. = ( 0xe75bc - code32flat_start ) ;
*32flat.*(.text.run_thread)
. = ( 0xe7645 - code32flat_start ) ;
*32flat.*(.text.alloc_add)
. = ( 0xe7698 - code32flat_start ) ;
*32flat.*(.text.xhci_alloc_inctx)
. = ( 0xe7778 - code32flat_start ) ;
*32flat.*(.text.usb_enumerate)
. = ( 0xe77ea - code32flat_start ) ;
*32flat.*(.text.romfile_loadfile)
. = ( 0xe7855 - code32flat_start ) ;
*32flat.*(.text.bootentry_add)
. = ( 0xe78f1 - code32flat_start ) ;
*32flat.*(.text.boot_add_hd)
. = ( 0xe790f - code32flat_start ) ;
*32flat.*(.text.boot_add_cd)
. = ( 0xe792d - code32flat_start ) ;
*32flat.*(.text.create_bounce_buf)
. = ( 0xe7964 - code32flat_start ) ;
*32flat.*(.text.init_atadrive)
. = ( 0xe79c2 - code32flat_start ) ;
*32flat.*(.text.nvme_init_cq)
. = ( 0xe7a34 - code32flat_start ) ;
*32flat.*(.text.nvme_init_sq)
. = ( 0xe7aaa - code32flat_start ) ;
*32flat.*(.text.__i8042_command)
. = ( 0xe7b31 - code32flat_start ) ;
*32flat.*(.text.i8042_flush)
. = ( 0xe7b64 - code32flat_start ) ;
*32flat.*(.text.configure_uhci)
. = ( 0xe7d24 - code32flat_start ) ;
*32flat.*(.text.ohci_hub_reset)
. = ( 0xe7daa - code32flat_start ) ;
*32flat.*(.text.configure_ohci)
. = ( 0xe800a - code32flat_start ) ;
*32flat.*(.text.send_ata_identity)
. = ( 0xe80b8 - code32flat_start ) ;
*32flat.*(.text.powerup_await_non_bsy)
. = ( 0xe8103 - code32flat_start ) ;
*32flat.*(.text.ahci_port_reset)
. = ( 0xe8198 - code32flat_start ) ;
*32flat.*(.text.ahci_port_release)
. = ( 0xe81c6 - code32flat_start ) ;
*32flat.*(.text.wait_bit)
. = ( 0xe8210 - code32flat_start ) ;
*32flat.*(.text.nvme_admin_identify)
. = ( 0xe82a0 - code32flat_start ) ;
*32flat.*(.text.nvme_wait_csts_rdy)
. = ( 0xe830c - code32flat_start ) ;
*32flat.*(.text.configure_ehci)
. = ( 0xe8543 - code32flat_start ) ;
*32flat.*(.text.find_prio)
. = ( 0xe85ba - code32flat_start ) ;
*32flat.*(.text.pci_enable_membar)
. = ( 0xe863f - code32flat_start ) ;
*32flat.*(.text.sdcard_set_frequency)
. = ( 0xe86d2 - code32flat_start ) ;
*32flat.*(.text.interface_init)
. = ( 0xe8ada - code32flat_start ) ;
*32flat.*(.text.pci_probe_devices)
. = ( 0xe8ca2 - code32flat_start ) ;
*32flat.*(.text.csm_maininit)
. = ( 0xe8cd3 - code32flat_start ) ;
*32flat.*(.text.init_floppy)
. = ( 0xe8d5a - code32flat_start ) ;
*32flat.*(.text.configure_xhci)
. = ( 0xe905c - code32flat_start ) ;
*32flat.*(.text.sdcard_pio_app.constprop.155)
. = ( 0xe9098 - code32flat_start ) ;
*32flat.*(.text.init_controller.constprop.123)
. = ( 0xe9135 - code32flat_start ) ;
*32flat.*(.text.found_genericata)
. = ( 0xe9201 - code32flat_start ) ;
*32flat.*(.text.xhci_print_port_state.constprop.130)
. = ( 0xe925d - code32flat_start ) ;
*32flat.*(.text.xhci_hub_reset)
. = ( 0xe92f6 - code32flat_start ) ;
*32flat.*(.text.ps2_recvbyte.constprop.150)
. = ( 0xe937a - code32flat_start ) ;
*32flat.*(.text.ps2_sendbyte.constprop.132)
. = ( 0xe93af - code32flat_start ) ;
*32flat.*(.text.ps2_kbd_command)
. = ( 0xe94dc - code32flat_start ) ;
*32flat.*(.text.ps2_keyboard_setup)
. = ( 0xe9627 - code32flat_start ) ;
*32flat.*(.text.enable_vga_console)
. = ( 0xe97b6 - code32flat_start ) ;
*32flat.*(.text.tpm12_activate_tpm.constprop.161)
. = ( 0xe982b - code32flat_start ) ;
*32flat.*(.text.tpm12_set_owner_install.constprop.163)
. = ( 0xe98b8 - code32flat_start ) ;
*32flat.*(.text.snprintf)
. = ( 0xe9903 - code32flat_start ) ;
*32flat.*(.text.bootprio_find_named_rom)
. = ( 0xe9954 - code32flat_start ) ;
*32flat.*(.text.build_usb_path.isra.79)
. = ( 0xe9998 - code32flat_start ) ;
*32flat.*(.text.build_pci_path.constprop.126)
. = ( 0xe9a48 - code32flat_start ) ;
*32flat.*(.text.bootprio_find_usb)
. = ( 0xe9ad8 - code32flat_start ) ;
*32flat.*(.text.znprintf.constprop.156)
. = ( 0xe9b37 - code32flat_start ) ;
*32flat.*(.text.sdcard_controller_setup.part.96)
. = ( 0xe9fb5 - code32flat_start ) ;
*32flat.*(.text.sdcard_pci_setup)
. = ( 0xe9fe7 - code32flat_start ) ;
*32flat.*(.text.sdcard_romfile_setup)
. = ( 0xea02f - code32flat_start ) ;
*32flat.*(.text.interactive_bootmenu)
. = ( 0xebd01 - code32flat_start ) ;
*32flat.*(.text.addFloppy)
. = ( 0xebd6a - code32flat_start ) ;
*32flat.*(.text.reloc_preinit)
. = ( 0xebe31 - code32flat_start ) ;
*32flat.*(.text.usb_send_default_control)
. = ( 0xebe4f - code32flat_start ) ;
*32flat.*(.text.get_port_status)
. = ( 0xebe93 - code32flat_start ) ;
*32flat.*(.text.usb_hub_detect)
. = ( 0xebebd - code32flat_start ) ;
*32flat.*(.text.set_port_feature)
. = ( 0xebefe - code32flat_start ) ;
*32flat.*(.text.usb_hub_disconnect)
. = ( 0xebf52 - code32flat_start ) ;
*32flat.*(.text.usb_hub_reset)
. = ( 0xebffd - code32flat_start ) ;
*32flat.*(.text.xhci_cmd_submit)
. = ( 0xec082 - code32flat_start ) ;
*32flat.*(.text.usb_realloc_pipe)
. = ( 0xecc57 - code32flat_start ) ;
*32flat.*(.text.usb_alloc_pipe)
. = ( 0xecc60 - code32flat_start ) ;
*32flat.*(.text.usb_free_pipe)
. = ( 0xecc6c - code32flat_start ) ;
*32flat.*(.text.prepareboot)
. = ( 0xed3f9 - code32flat_start ) ;
*32flat.*(.text.device_hardware_setup)
. = ( 0xedea4 - code32flat_start ) ;
*32flat.*(.text.timer_setup.part.72)
. = ( 0xedfc9 - code32flat_start ) ;
*32flat.*(.text.nvme_controller_setup)
. = ( 0xee3c4 - code32flat_start ) ;
*32flat.*(.text.ata_detect)
. = ( 0xee785 - code32flat_start ) ;
*32flat.*(.text.ahci_port_setup)
. = ( 0xeebb4 - code32flat_start ) ;
*32flat.*(.text.ahci_port_detect)
. = ( 0xeed22 - code32flat_start ) ;
*32flat.*(.text.init../src/stacks.c.732)
. = ( 0xeed32 - code32flat_start ) ;
*32flat.*(.text.scsi_drive_setup)
. = ( 0xeef68 - code32flat_start ) ;
*32flat.*(.text.megasas_scan_target)
. = ( 0xef159 - code32flat_start ) ;
*32flat.*(.text.init_megasas)
. = ( 0xef31d - code32flat_start ) ;
*32flat.*(.text.usb_hub_port_setup)
. = ( 0xefdb9 - code32flat_start ) ;
*32flat.*(.text.init../src/pmm.c.120)
. = ( 0xeff49 - code32flat_start ) ;
*32flat.*(.text.init../src/fw/csm.c.283)
. = ( 0xf02f8 - code32flat_start ) ;
*32flat.*(.rodata.interactive_bootmenu)
. = ( 0xf031c - code32flat_start ) ;
*32flat.*(.rodata.init../src/fw/csm.c.283)
. = ( 0xf0338 - code32flat_start ) ;
*32flat.*(.rodata.CSWTCH.1737)
. = ( 0xf034c - code32flat_start ) ;
*32flat.*(.rodata.__func__.16184)
. = ( 0xf035c - code32flat_start ) ;
*32flat.*(.rodata.__func__.16164)
. = ( 0xf0370 - code32flat_start ) ;
*32flat.*(.rodata.__func__.16241)
. = ( 0xf0384 - code32flat_start ) ;
*32flat.*(.rodata.__func__.16113)
. = ( 0xf0394 - code32flat_start ) ;
*32flat.*(.rodata.__func__.16120)
. = ( 0xf03a4 - code32flat_start ) ;
*32flat.*(.rodata.__func__.16252)
. = ( 0xf03bc - code32flat_start ) ;
*32flat.*(.rodata.__func__.16266)
. = ( 0xf03d4 - code32flat_start ) ;
*32flat.*(.rodata.__func__.13758)
. = ( 0xf03e0 - code32flat_start ) ;
*32flat.*(.rodata.__func__.12781)
. = ( 0xf03f4 - code32flat_start ) ;
*32flat.*(.rodata.__func__.12799)
. = ( 0xf040c - code32flat_start ) ;
*32flat.*(.rodata.__func__.12617)
. = ( 0xf041c - code32flat_start ) ;
*32flat.*(.rodata.__func__.12453)
. = ( 0xf0430 - code32flat_start ) ;
*32flat.*(.rodata.__func__.12414)
. = ( 0xf0440 - code32flat_start ) ;
*32flat.*(.rodata.__func__.12477)
. = ( 0xf0450 - code32flat_start ) ;
*32flat.*(.rodata.__func__.12488)
. = ( 0xf0460 - code32flat_start ) ;
*32flat.*(.rodata.__func__.12514)
. = ( 0xf0474 - code32flat_start ) ;
*32flat.*(.rodata.__func__.12235)
. = ( 0xf0480 - code32flat_start ) ;
*32flat.*(.rodata.__func__.12266)
. = ( 0xf0490 - code32flat_start ) ;
*32flat.*(.rodata.__func__.12297)
. = ( 0xf04a0 - code32flat_start ) ;
*32flat.*(.rodata.__func__.12312)
. = ( 0xf04b8 - code32flat_start ) ;
*32flat.*(.rodata.__func__.11863)
. = ( 0xf04c8 - code32flat_start ) ;
*32flat.*(.rodata.__func__.11872)
. = ( 0xf04dc - code32flat_start ) ;
*32flat.*(.rodata.__func__.11889)
. = ( 0xf04ec - code32flat_start ) ;
*32flat.*(.rodata.__func__.11856)
. = ( 0xf04fc - code32flat_start ) ;
*32flat.*(.rodata.__func__.11921)
. = ( 0xf0514 - code32flat_start ) ;
*32flat.*(.rodata.__func__.11739)
. = ( 0xf0528 - code32flat_start ) ;
*32flat.*(.rodata.__func__.11733)
. = ( 0xf053c - code32flat_start ) ;
*32flat.*(.rodata.__func__.11663)
. = ( 0xf0550 - code32flat_start ) ;
*32flat.*(.rodata.evt_separator.11294)
. = ( 0xf0554 - code32flat_start ) ;
*32flat.*(.rodata.__func__.9929)
. = ( 0xf0568 - code32flat_start ) ;
*32flat.*(.rodata.__func__.9620)
. = ( 0xf0578 - code32flat_start ) ;
*32flat.*(.rodata.__func__.9504)
. = ( 0xf0588 - code32flat_start ) ;
*32flat.*(.rodata.__func__.9233)
. = ( 0xf059c - code32flat_start ) ;
*32flat.*(.rodata.__func__.9112)
. = ( 0xf05a8 - code32flat_start ) ;
*32flat.*(.rodata.__func__.9041)
. = ( 0xf05b0 - code32flat_start ) ;
*32flat.*(.rodata.__func__.8938)
. = ( 0xf05c4 - code32flat_start ) ;
*32flat.*(.rodata.__func__.8816)
. = ( 0xf05d0 - code32flat_start ) ;
*32flat.*(.rodata.__func__.8372)
. = ( 0xf05e0 - code32flat_start ) ;
*32flat.*(.rodata.__func__.8379)
. = ( 0xf05f4 - code32flat_start ) ;
*32flat.*(.rodata.__func__.8088)
. = ( 0xf0604 - code32flat_start ) ;
*32flat.*(.rodata.__func__.7974)
. = ( 0xf0614 - code32flat_start ) ;
*32flat.*(.rodata.__func__.8004)
. = ( 0xf062c - code32flat_start ) ;
*32flat.*(.rodata.__func__.8038)
. = ( 0xf063c - code32flat_start ) ;
*32flat.*(.rodata.__func__.7785)
. = ( 0xf0648 - code32flat_start ) ;
*32flat.*(.rodata.__func__.7556)
. = ( 0xf0654 - code32flat_start ) ;
*32flat.*(.rodata.__func__.7508)
. = ( 0xf0668 - code32flat_start ) ;
*32flat.*(.rodata.__func__.7348)
. = ( 0xf0674 - code32flat_start ) ;
*32flat.*(.rodata.__func__.7248)
. = ( 0xf0688 - code32flat_start ) ;
*32flat.*(.rodata.__func__.6960)
. = ( 0xf06a0 - code32flat_start ) ;
*32flat.*(.rodata.__func__.6987)
. = ( 0xf06b4 - code32flat_start ) ;
*32flat.*(.rodata.__func__.6899)
. = ( 0xf06c4 - code32flat_start ) ;
*32flat.*(.rodata.__func__.6916)
. = ( 0xf06dc - code32flat_start ) ;
*32flat.*(.rodata.__func__.6760)
. = ( 0xf06f0 - code32flat_start ) ;
*32flat.*(.rodata.__func__.6634)
. = ( 0xf0700 - code32flat_start ) ;
*32flat.*(.rodata.__func__.6671)
. = ( 0xf070c - code32flat_start ) ;
*32flat.*(.rodata.__func__.6684)
. = ( 0xf071c - code32flat_start ) ;
*32flat.*(.rodata.__func__.6698)
. = ( 0xf0734 - code32flat_start ) ;
*32flat.*(.rodata.__func__.6509)
. = ( 0xf074c - code32flat_start ) ;
*32flat.*(.rodata.__func__.6535)
. = ( 0xf0760 - code32flat_start ) ;
*32flat.*(.rodata.__func__.6469)
. = ( 0xf0770 - code32flat_start ) ;
*32flat.*(.rodata.__func__.6481)
. = ( 0xf0788 - code32flat_start ) ;
*32flat.*(.rodata.__func__.6335)
. = ( 0xf079c - code32flat_start ) ;
*32flat.*(.rodata.__func__.6379)
. = ( 0xf07ac - code32flat_start ) ;
*32flat.*(.rodata.__func__.5697)
. = ( 0xf07b8 - code32flat_start ) ;
*32flat.*(.rodata.__func__.5810)
. = ( 0xf07cc - code32flat_start ) ;
*32flat.*(.rodata.__func__.5678)
. = ( 0xf07dc - code32flat_start ) ;
*32flat.*(.rodata.__func__.5739)
. = ( 0xf07ec - code32flat_start ) ;
*32flat.*(.rodata.__func__.3655)
. = ( 0xf07fc - code32flat_start ) ;
*32flat.*(.rodata.__func__.3391)
. = ( 0xf0808 - code32flat_start ) ;
*32flat.*(.rodata.__func__.3341)
. = ( 0xf081c - code32flat_start ) ;
*32flat.*(.rodata.__func__.2892)
. = ( 0xf0828 - code32flat_start ) ;
*32flat.*(.rodata.speed_to_xhci)
. = ( 0xf0840 - code32flat_start ) ;
*32flat.*(.rodata.speed_from_xhci)
. = ( 0xf0880 - code32flat_start ) ;
*32flat.*(.rodata.speed_name)
. = ( 0xf08c0 - code32flat_start ) ;
*32flat.*(.rodata.aaidct)
. = ( 0xf08e0 - code32flat_start ) ;
*32flat.*(.rodata.zig)
. = ( 0xf0920 - code32flat_start ) ;
*32flat.*(.rodata.pci_ata_tbl)
. = ( 0xf095c - code32flat_start ) ;
*32flat.*(.rodata.speed_to_ctlsize)
. = ( 0xf096c - code32flat_start ) ;
*32flat.*(.data.PICMask)
. = ( 0xf0970 - code32flat_start ) ;
*32flat.*(.data.HubOp)
. = ( 0xf0980 - code32flat_start ) ;
*32flat.*(.data.xhci_hub_ops)
. = ( 0xf0990 - code32flat_start ) ;
*32flat.*(.data.varinit../src/hw/pcidevice.c.16)
. = ( 0xf09a0 - code32flat_start ) ;
*32flat.*(.data.zig2)
. = ( 0xf09e0 - code32flat_start ) ;
*32flat.*(.data.varinit../src/boot.c.309)
. = ( 0xf09e4 - code32flat_start ) ;
*32flat.*(.data.varinit../src/boot.c.30)
. = ( 0xf09e8 - code32flat_start ) ;
*32flat.*(.data.varinit../src/romfile.c.13)
. = ( 0xf09ec - code32flat_start ) ;
*32flat.*(.data.RomEnd)
. = ( 0xf09f0 - code32flat_start ) ;
*32flat.*(.data.varinit../src/malloc.c.40)
. = ( 0xf0a04 - code32flat_start ) ;
*32flat.*(.data.varinit../src/malloc.c.38)
. = ( 0xf0a0c - code32flat_start ) ;
*32flat.*(.data.varinit../src/malloc.c.37)
. = ( 0xf0a10 - code32flat_start ) ;
*32flat.*(.data.varinit../src/malloc.c.36)
. = ( 0xf0a18 - code32flat_start ) ;
*32flat.*(.data.ehci_HubOp)
. = ( 0xf0a28 - code32flat_start ) ;
*32flat.*(.data.ohci_HubOp)
. = ( 0xf0a38 - code32flat_start ) ;
*32flat.*(.data.uhci_HubOp)
. = ( 0xf0a48 - code32flat_start ) ;
*32flat.*(.data.VERSION)
. = ( 0xf0a60 - code32flat_start ) ;
*32flat.*(.bss.ataid.8036)
. = ( 0xf0a64 - code32flat_start ) ;
*32flat.*(.bss.SMBiosAddr)
. = ( 0xf0a68 - code32flat_start ) ;
*32flat.*(.bss.csm_boot_table)
. = ( 0xf0a6c - code32flat_start ) ;
*32flat.*(.bss.csm_init_table)
. = ( 0xf0a70 - code32flat_start ) ;
*32flat.*(.bss.TPM_has_physical_presence)
. = ( 0xf0a74 - code32flat_start ) ;
*32flat.*(.bss.BootsplashActive)
. = ( 0xf0a78 - code32flat_start ) ;
*32flat.*(.bss.HaveFDBoot)
. = ( 0xf0a7c - code32flat_start ) ;
*32flat.*(.bss.HaveHDBoot)
. = ( 0xf0a80 - code32flat_start ) ;
*32flat.*(.bss.BootorderCount)
. = ( 0xf0a84 - code32flat_start ) ;
*32flat.*(.bss.RomBase)
. = ( 0xf0a88 - code32flat_start ) ;
*32flat.*(.bss.SpinupEnd)
. = ( 0xf0a8c - code32flat_start ) ;
*32flat.*(.bss.PendingEHCI)
. = ( 0xf0a90 - code32flat_start ) ;
*32flat.*(.bss.usb_time_sigatt)
. = ( 0xf0a94 - code32flat_start ) ;
*32flat.*(.bss.CDCount)
. = ( 0xf0aa0 - code32flat_start ) ;
*32flat.*(.text.switch_next)
. = ( 0xf0abe - code32flat_start ) ;
*32flat.*(.text.debug_putc)
. = ( 0xf0abf - code32flat_start ) ;
*32flat.*(.text.putc)
. = ( 0xf0ac4 - code32flat_start ) ;
*32flat.*(.text.putsinglehex)
. = ( 0xf0ad6 - code32flat_start ) ;
*32flat.*(.text.puthex)
. = ( 0xf0b59 - code32flat_start ) ;
*32flat.*(.text.putprettyhex)
. = ( 0xf0ba0 - code32flat_start ) ;
*32flat.*(.text.strlen)
. = ( 0xf0baf - code32flat_start ) ;
*32flat.*(.text.strcmp)
. = ( 0xf0bcf - code32flat_start ) ;
*32flat.*(.text.memset)
. = ( 0xf0bda - code32flat_start ) ;
*32flat.*(.text.ahci_port_readl)
. = ( 0xf0bea - code32flat_start ) ;
*32flat.*(.text.ahci_port_writel)
. = ( 0xf0c00 - code32flat_start ) ;
*32flat.*(.text.find_acpi_table)
. = ( 0xf0c57 - code32flat_start ) ;
*32flat.*(.text.crb_get_tpm_version)
. = ( 0xf0c5a - code32flat_start ) ;
*32flat.*(.text.crb_activate)
. = ( 0xf0c6a - code32flat_start ) ;
*32flat.*(.text.crb_waitdatavalid)
. = ( 0xf0c6d - code32flat_start ) ;
*32flat.*(.text.nvme_commit_sqe)
. = ( 0xf0c84 - code32flat_start ) ;
*32flat.*(.text.tpm_log_event)
. = ( 0xf0cf3 - code32flat_start ) ;
*32flat.*(.text.set_timeouts)
. = ( 0xf0d4a - code32flat_start ) ;
*32flat.*(.text.cpu_to_be32)
. = ( 0xf0d4d - code32flat_start ) ;
*32flat.*(.text.sha1_block)
. = ( 0xf0eb1 - code32flat_start ) ;
*32flat.*(.text.tpmhw_transmit)
. = ( 0xf0f1a - code32flat_start ) ;
*32flat.*(.text.tpm_build_digest)
. = ( 0xf103f - code32flat_start ) ;
*32flat.*(.text.sha1_do)
. = ( 0xf1126 - code32flat_start ) ;
*32flat.*(.text.sha1)
. = ( 0xf115b - code32flat_start ) ;
*32flat.*(.text.tpm_simple_cmd)
. = ( 0xf1205 - code32flat_start ) ;
*32flat.*(.text.threads_during_optionroms)
. = ( 0xf121d - code32flat_start ) ;
*32flat.*(.text.default_process_op.isra.5)
. = ( 0xf123c - code32flat_start ) ;
*32flat.*(.text.tis_get_tpm_version)
. = ( 0xf1263 - code32flat_start ) ;
*32flat.*(.text.crb_senddata)
. = ( 0xf128e - code32flat_start ) ;
*32flat.*(.text.init_timeout)
. = ( 0xf12e1 - code32flat_start ) ;
*32flat.*(.text.crb_init)
. = ( 0xf1311 - code32flat_start ) ;
*32flat.*(.text.tis_init)
. = ( 0xf1325 - code32flat_start ) ;
*32flat.*(.text.scsi_fill_cmd)
. = ( 0xf1386 - code32flat_start ) ;
*32flat.*(.text.crb_readresp)
. = ( 0xf13e4 - code32flat_start ) ;
*32flat.*(.text.pic_reset.constprop.134)
. = ( 0xf1409 - code32flat_start ) ;
*32flat.*(.text.checksum)
. = ( 0xf141c - code32flat_start ) ;
*32flat.*(.text.tpm_extend)
. = ( 0xf1530 - code32flat_start ) ;
*32flat.*(.text.hash_log_extend.isra.102.part.103)
. = ( 0xf15d5 - code32flat_start ) ;
*32flat.*(.text.tpm20_hierarchycontrol.constprop.174)
. = ( 0xf1660 - code32flat_start ) ;
*32flat.*(.text.tpm_set_failure)
. = ( 0xf169f - code32flat_start ) ;
*32flat.*(.text.tpm_add_measurement_to_log)
. = ( 0xf1746 - code32flat_start ) ;
*32flat.*(.text.tpm_add_action)
. = ( 0xf1766 - code32flat_start ) ;
*32flat.*(.text.irqtimer_calc.part.15)
. = ( 0xf17a2 - code32flat_start ) ;
*32flat.*(.text.rtc_use)
. = ( 0xf17c0 - code32flat_start ) ;
*32flat.*(.text.timer_read)
. = ( 0xf182f - code32flat_start ) ;
*32flat.*(.text.timer_calc)
. = ( 0xf1842 - code32flat_start ) ;
*32flat.*(.text.timer_calc_usec)
. = ( 0xf1889 - code32flat_start ) ;
*32flat.*(.text.timer_check)
. = ( 0xf189d - code32flat_start ) ;
*32flat.*(.text.timer_delay)
. = ( 0xf18b1 - code32flat_start ) ;
*32flat.*(.text.udelay)
. = ( 0xf18bb - code32flat_start ) ;
*32flat.*(.text.ndelay.constprop.140)
. = ( 0xf18e3 - code32flat_start ) ;
*32flat.*(.text.putuint)
. = ( 0xf192a - code32flat_start ) ;
*32flat.*(.text.bvprintf)
. = ( 0xf1ba2 - code32flat_start ) ;
*32flat.*(.text.panic)
. = ( 0xf1bb8 - code32flat_start ) ;
*32flat.*(.text.call16)
. = ( 0xf1c09 - code32flat_start ) ;
*32flat.*(.text.__call16_int)
. = ( 0xf1c2b - code32flat_start ) ;
*32flat.*(.text.screenc)
. = ( 0xf1c6c - code32flat_start ) ;
*32flat.*(.text.screen_putc)
. = ( 0xf1c87 - code32flat_start ) ;
*32flat.*(.text.yield)
. = ( 0xf1cc1 - code32flat_start ) ;
*32flat.*(.text.finish_preempt)
. = ( 0xf1cf7 - code32flat_start ) ;
*32flat.*(.text.yield_toirq)
. = ( 0xf1d1f - code32flat_start ) ;
*32flat.*(.text.reset)
. = ( 0xf1d32 - code32flat_start ) ;
*32flat.*(.text.call16_override)
. = ( 0xf1d6d - code32flat_start ) ;
*32flat.*(.text.__dprintf)
. = ( 0xf1d80 - code32flat_start ) ;
*32flat.*(.text.__warn_internalerror)
. = ( 0xf1d90 - code32flat_start ) ;
*32flat.*(.text.nvme_get_next_sqe.constprop.139)
. = ( 0xf1e0b - code32flat_start ) ;
*32flat.*(.text.__warn_noalloc)
. = ( 0xf1e1b - code32flat_start ) ;
*32flat.*(.text.__warn_timeout)
. = ( 0xf1e2b - code32flat_start ) ;
*32flat.*(.text.i8042_wait_write)
. = ( 0xf1e5c - code32flat_start ) ;
*32flat.*(.text.uhci_waittick)
. = ( 0xf1ea5 - code32flat_start ) ;
*32flat.*(.text.ohci_waittick)
. = ( 0xf1eed - code32flat_start ) ;
*32flat.*(.text.ehci_waittick.isra.60)
. = ( 0xf1f6b - code32flat_start ) ;
*32flat.*(.text.await_ide.constprop.143)
. = ( 0xf1fbf - code32flat_start ) ;
*32flat.*(.text.await_not_bsy)
. = ( 0xf1fce - code32flat_start ) ;
*32flat.*(.text.send_cmd)
. = ( 0xf2092 - code32flat_start ) ;
*32flat.*(.text.ata_pio_transfer.constprop.142)
. = ( 0xf2125 - code32flat_start ) ;
*32flat.*(.text.ata_wait_data)
. = ( 0xf2151 - code32flat_start ) ;
*32flat.*(.text.ahci_command)
. = ( 0xf236f - code32flat_start ) ;
*32flat.*(.text.ahci_disk_readwrite_aligned)
. = ( 0xf2457 - code32flat_start ) ;
*32flat.*(.text.ahci_disk_readwrite)
. = ( 0xf2524 - code32flat_start ) ;
*32flat.*(.text.sdcard_reset)
. = ( 0xf2562 - code32flat_start ) ;
*32flat.*(.text.wait_reg8)
. = ( 0xf25af - code32flat_start ) ;
*32flat.*(.text.crb_probe)
. = ( 0xf2618 - code32flat_start ) ;
*32flat.*(.text.tis_activate)
. = ( 0xf2684 - code32flat_start ) ;
*32flat.*(.text.tis_find_active_locality)
. = ( 0xf26ab - code32flat_start ) ;
*32flat.*(.text.tis_readresp)
. = ( 0xf26ea - code32flat_start ) ;
*32flat.*(.text.tis_probe)
. = ( 0xf2748 - code32flat_start ) ;
*32flat.*(.text.crb_waitrespready)
. = ( 0xf2764 - code32flat_start ) ;
*32flat.*(.text.crb_ready)
. = ( 0xf2789 - code32flat_start ) ;
*32flat.*(.text.tis_waitdatavalid)
. = ( 0xf27bd - code32flat_start ) ;
*32flat.*(.text.tis_ready)
. = ( 0xf27f1 - code32flat_start ) ;
*32flat.*(.text.tis_waitrespready)
. = ( 0xf2831 - code32flat_start ) ;
*32flat.*(.text.tis_senddata)
. = ( 0xf28ce - code32flat_start ) ;
*32flat.*(.text.nvme_wait)
. = ( 0xf29b9 - code32flat_start ) ;
*32flat.*(.text.wait_td)
. = ( 0xf2a0d - code32flat_start ) ;
*32flat.*(.text.uhci_send_pipe)
. = ( 0xf2ca1 - code32flat_start ) ;
*32flat.*(.text.ohci_send_pipe)
. = ( 0xf2e81 - code32flat_start ) ;
*32flat.*(.text.ehci_send_pipe)
. = ( 0xf30f0 - code32flat_start ) ;
*32flat.*(.text.megasas_fire_cmd)
. = ( 0xf318d - code32flat_start ) ;
*32flat.*(.text.is_valid_rom.part.77)
. = ( 0xf31d5 - code32flat_start ) ;
*32flat.*(.text.call_boot_entry)
. = ( 0xf3237 - code32flat_start ) ;
*32flat.*(.text.sdcard_waitw)
. = ( 0xf329f - code32flat_start ) ;
*32flat.*(.text.xhci_process_events)
. = ( 0xf338e - code32flat_start ) ;
*32flat.*(.text.xhci_event_wait)
. = ( 0xf33e6 - code32flat_start ) ;
*32flat.*(.text.sdcard_pio)
. = ( 0xf3461 - code32flat_start ) ;
*32flat.*(.text.sdcard_pio_transfer)
. = ( 0xf3575 - code32flat_start ) ;
*32flat.*(.text.printf)
. = ( 0xf3588 - code32flat_start ) ;
*32flat.*(.text.boot_fail)
. = ( 0xf3609 - code32flat_start ) ;
*32flat.*(.text.boot_disk)
. = ( 0xf3707 - code32flat_start ) ;
*32flat.*(.text.__callrom)
. = ( 0xf37b8 - code32flat_start ) ;
*32flat.*(.text.xhci_trb_queue)
. = ( 0xf385b - code32flat_start ) ;
*32flat.*(.text.xhci_xfer_normal)
. = ( 0xf3885 - code32flat_start ) ;
*32flat.*(.text.usb_send_pipe)
. = ( 0xf39ce - code32flat_start ) ;
*32flat.*(.text.usb_process_op)
. = ( 0xf3af5 - code32flat_start ) ;
*32flat.*(.text.uas_process_op)
. = ( 0xf3c6a - code32flat_start ) ;
*32flat.*(.text.runtime../src/stacks.c.757)
. = ( 0xf3c7a - code32flat_start ) ;
*32flat.*(.text.runtime../src/block.c.555)
. = ( 0xf4137 - code32flat_start ) ;
*32flat.*(.text.process_op)
. = ( 0xf4178 - code32flat_start ) ;
*32flat.*(.text.scsi_is_ready)
. = ( 0xf4279 - code32flat_start ) ;
*32flat.*(.text.cdrom_boot)
. = ( 0xf4581 - code32flat_start ) ;
*32flat.*(.text.do_boot)
. = ( 0xf46f3 - code32flat_start ) ;
*32flat.*(.text.runtime../src/resume.c.146)
. = ( 0xf492a - code32flat_start ) ;
*32flat.*(.text.runtime../src/post.c.182)
. = ( 0xf496a - code32flat_start ) ;
*32flat.*(.text.runtime../src/post.c.320)
. = ( 0xf496b - code32flat_start ) ;
*32flat.*(.text.runtime../src/boot.c.767)
. = ( 0xf4997 - code32flat_start ) ;
*32flat.*(.text.runtime../src/boot.c.777)
. = ( 0xf49c4 - code32flat_start ) ;
*32flat.*(.text.runtime../src/tcgbios.c.1412)
. = ( 0xf4cfe - code32flat_start ) ;
*32flat.*(.text.runtime../src/hw/usb-xhci.c.1131)
. = ( 0xf4d68 - code32flat_start ) ;
_rodata32flat = . ;
*32flat.*(.rodata)
. = ( 0xf6a24 - code32flat_start ) ;
*32flat.*(.rodata.puthex)
. = ( 0xf6a40 - code32flat_start ) ;
*32flat.*(.rodata.runtime../src/tcgbios.c.1412)
. = ( 0xf6a60 - code32flat_start ) ;
*32flat.*(.rodata.CSWTCH.1803)
. = ( 0xf6a70 - code32flat_start ) ;
*32flat.*(.rodata.__func__.16143)
. = ( 0xf6a7c - code32flat_start ) ;
*32flat.*(.rodata.__func__.16154)
. = ( 0xf6a90 - code32flat_start ) ;
*32flat.*(.rodata.__func__.16223)
. = ( 0xf6aa4 - code32flat_start ) ;
*32flat.*(.rodata.__func__.15896)
. = ( 0xf6ab4 - code32flat_start ) ;
*32flat.*(.rodata.__func__.15817)
. = ( 0xf6ac0 - code32flat_start ) ;
*32flat.*(.rodata.__func__.12681)
. = ( 0xf6ad0 - code32flat_start ) ;
*32flat.*(.rodata.__func__.12688)
. = ( 0xf6ae0 - code32flat_start ) ;
*32flat.*(.rodata.__func__.12551)
. = ( 0xf6af0 - code32flat_start ) ;
*32flat.*(.rodata.__func__.12368)
. = ( 0xf6b04 - code32flat_start ) ;
*32flat.*(.rodata.__func__.12390)
. = ( 0xf6b14 - code32flat_start ) ;
*32flat.*(.rodata.__func__.11803)
. = ( 0xf6b24 - code32flat_start ) ;
*32flat.*(.rodata.sha_ko.11617)
. = ( 0xf6b34 - code32flat_start ) ;
*32flat.*(.rodata.__func__.9824)
. = ( 0xf6b40 - code32flat_start ) ;
*32flat.*(.rodata.__func__.9819)
. = ( 0xf6b4c - code32flat_start ) ;
*32flat.*(.rodata.__func__.8344)
. = ( 0xf6b60 - code32flat_start ) ;
*32flat.*(.rodata.__func__.7759)
. = ( 0xf6b6c - code32flat_start ) ;
*32flat.*(.rodata.__func__.7002)
. = ( 0xf6b7c - code32flat_start ) ;
*32flat.*(.rodata.__func__.7034)
. = ( 0xf6b8c - code32flat_start ) ;
*32flat.*(.rodata.__func__.6871)
. = ( 0xf6b9c - code32flat_start ) ;
*32flat.*(.rodata.__func__.6767)
. = ( 0xf6ba4 - code32flat_start ) ;
*32flat.*(.rodata.__func__.6787)
. = ( 0xf6bb4 - code32flat_start ) ;
*32flat.*(.rodata.__func__.6649)
. = ( 0xf6bc4 - code32flat_start ) ;
*32flat.*(.rodata.__func__.6542)
. = ( 0xf6bd0 - code32flat_start ) ;
*32flat.*(.rodata.__func__.6552)
. = ( 0xf6bd8 - code32flat_start ) ;
*32flat.*(.rodata.__func__.6438)
. = ( 0xf6be8 - code32flat_start ) ;
*32flat.*(.rodata.__func__.5687)
. = ( 0xf6bfc - code32flat_start ) ;
*32flat.*(.rodata.tpm_default_durations)
. = ( 0xf6c08 - code32flat_start ) ;
*32flat.*(.rodata.tis_default_timeouts)
. = ( 0xf6c18 - code32flat_start ) ;
*32flat.*(.data.TPMHW_driver_to_use)
. = ( 0xf6c20 - code32flat_start ) ;
*32flat.*(.data.tpm_drivers)
. = ( 0xf6c80 - code32flat_start ) ;
*32flat.*(.data.screeninfo)
. = ( 0xf6c84 - code32flat_start ) ;
*32flat.*(.data.debuginfo)
. = ( 0xf6c88 - code32flat_start ) ;
*32flat.*(.bss.crb_resp)
. = ( 0xf6c8c - code32flat_start ) ;
*32flat.*(.bss.crb_cmd)
. = ( 0xf6c90 - code32flat_start ) ;
*32flat.*(.bss.crb_cmd_size)
. = ( 0xf6c94 - code32flat_start ) ;
*32flat.*(.bss.tpm_default_to)
. = ( 0xf6ca4 - code32flat_start ) ;
*32flat.*(.bss.tpm_default_dur)
. = ( 0xf6cb0 - code32flat_start ) ;
*32flat.*(.bss.acpi_reset_val)
. = ( 0xf6cb4 - code32flat_start ) ;
*32flat.*(.bss.acpi_reset_reg)
. = ( 0xf6cc0 - code32flat_start ) ;
*32flat.*(.bss.RsdpAddr)
. = ( 0xf6cc4 - code32flat_start ) ;
*32flat.*(.bss.tpm20_pcr_selection)
. = ( 0xf6cc8 - code32flat_start ) ;
*32flat.*(.bss.tpm20_pcr_selection_size)
. = ( 0xf6ccc - code32flat_start ) ;
*32flat.*(.bss.TPM_version)
. = ( 0xf6cd0 - code32flat_start ) ;
*32flat.*(.bss.BEVCount)
. = ( 0xf6ce0 - code32flat_start ) ;
*32flat.*(.bss.BEV)
. = ( 0xf6d80 - code32flat_start ) ;
*32flat.*(.bss.BootRetryTime)
. = ( 0xf6d84 - code32flat_start ) ;
*32flat.*(.bss.VgaROM)
. = ( 0xf6d88 - code32flat_start ) ;
*32flat.*(.bss.S3ResumeVga)
. = ( 0xf6d8c - code32flat_start ) ;
*32flat.*(.bss.EnforceChecksum)
. = ( 0xf6d90 - code32flat_start ) ;
*32flat.*(.bss.PreemptCount)
. = ( 0xf6d94 - code32flat_start ) ;
*32flat.*(.bss.ThreadControl)
. = ( 0xf6d95 - code32flat_start ) ;
*32flat.*(.bss.CanInterrupt)
. = ( 0xf6da0 - code32flat_start ) ;
*32flat.*(.data.varfseg../src/fw/biostables.c.177)
. = ( 0xf6da4 - code32flat_start ) ;
*32flat.*(.data.varfseg../src/fw/biostables.c.22)
. = ( 0xf6db0 - code32flat_start ) ;
*32flat.*(.data.varfseg../src/fw/csm.c.31)
. = ( 0xf6e20 - code32flat_start ) ;
*32flat.*(.data.varfseg../src/fw/csm.c.29)
. = ( 0xf6e44 - code32flat_start ) ;
*32flat.*(.data.varfseg../src/hw/pcidevice.c.17)
. = ( 0xf6e50 - code32flat_start ) ;
*32flat.*(.data.varfseg../src/pmm.c.19)
. = ( 0xf6e60 - code32flat_start ) ;
*32flat.*(.data.varfseg../src/malloc.c.468)
. = ( 0xf6e64 - code32flat_start ) ;
*32flat.*(.data.varfseg../src/e820map.c.19)
. = ( 0xf6e80 - code32flat_start ) ;
*32flat.*(.data.varfseg../src/e820map.c.18)
. = ( 0xf7100 - code32flat_start ) ;
*32flat.*(.data.varfseg../src/hw/floppy.c.88)
. = ( 0xf715c - code32flat_start ) ;
*32flat.*(.data.varfseg../src/hw/floppy.c.55)
. = ( 0xf716c - code32flat_start ) ;
*32flat.*(.data.varfseg../src/hw/usb-hid.c.16)
. = ( 0xf7170 - code32flat_start ) ;
*32flat.*(.data.varfseg../src/hw/usb-hid.c.15)
. = ( 0xf7174 - code32flat_start ) ;
*32flat.*(.data.varfseg../src/hw/timer.c.54)
. = ( 0xf7176 - code32flat_start ) ;
*32flat.*(.data.varfseg../src/hw/timer.c.53)
. = ( 0xf7178 - code32flat_start ) ;
*32flat.*(.data.varfseg../src/hw/timer.c.52)
. = ( 0xf7180 - code32flat_start ) ;
*32flat.*(.data.varfseg../src/pcibios.c.229)
. = ( 0xf7190 - code32flat_start ) ;
*32flat.*(.data.varfseg../src/vgahooks.c.262)
. = ( 0xf7191 - code32flat_start ) ;
*32flat.*(.data.varfseg../src/vgahooks.c.179)
. = ( 0xf7194 - code32flat_start ) ;
*32flat.*(.data.varfseg../src/vgahooks.c.40)
. = ( 0xf719c - code32flat_start ) ;
*32flat.*(.data.varfseg../src/vgahooks.c.22)
. = ( 0xf71a0 - code32flat_start ) ;
*32flat.*(.data.varfseg../src/pnpbios.c.18)
. = ( 0xf71c4 - code32flat_start ) ;
*32flat.*(.data.varfseg../src/cdrom.c.27)
. = ( 0xf71c8 - code32flat_start ) ;
*32flat.*(.data.varfseg../src/block.c.34)
. = ( 0xf71e0 - code32flat_start ) ;
*32flat.*(.data.varfseg../src/block.c.33)
. = ( 0xf72a0 - code32flat_start ) ;
*32flat.*(.data.varfseg../src/block.c.31)
. = ( 0xf72a4 - code32flat_start ) ;
*32flat.*(.data.varfseg../src/stacks.c.691)
. = ( 0xf72a8 - code32flat_start ) ;
*32flat.*(.data.varfseg../src/stacks.c.476)
. = ( 0xf72b4 - code32flat_start ) ;
*32flat.*(.data.varfseg../src/misc.c.166)
. = ( 0xf72c0 - code32flat_start ) ;
*32flat.*(.data.varfseg../src/misc.c.148)
. = ( 0xf72f8 - code32flat_start ) ;
*32flat.*(.data.varfseg../src/misc.c.142)
. = ( 0xf72fe - code32flat_start ) ;
*32flat.*(.data.varfseg../src/misc.c.139)
. = ( 0xf7300 - code32flat_start ) ;
*32flat.*(.data.varfseg../src/misc.c.132)
. = ( 0xf7308 - code32flat_start ) ;
*32flat.*(.data.varfseg../src/misc.c.18)
. = ( 0xf7310 - code32flat_start ) ;
*32flat.*(.text.32fseg../src/stacks.c.300)
. = ( 0xf733e - code32flat_start ) ;
*32seg.*(.text.set_code_success)
. = ( 0xf7348 - code32flat_start ) ;
*32seg.*(.text.get_global_offset)
. = ( 0xf7354 - code32flat_start ) ;
*32seg.*(.text.pci_next)
. = ( 0xf73c8 - code32flat_start ) ;
*32seg.*(.text.putuint.isra.8)
. = ( 0xf73f7 - code32flat_start ) ;
*32seg.*(.text.__dprintf)
. = ( 0xf7512 - code32flat_start ) ;
*32seg.*(.text.handle_pcibios)
. = ( 0xf783d - code32flat_start ) ;
*32seg.*(.text.handle_apm)
. = ( 0xf79b6 - code32flat_start ) ;
_rodata32seg = . ;
*32seg.*(.rodata)
. = ( 0xf79e0 - code32flat_start ) ;
*16.*(.text.set_a20)
. = ( 0xf7a00 - code32flat_start ) ;
*16.*(.text.set_code_success)
. = ( 0xf7a0c - code32flat_start ) ;
*16.*(.text.call32_prep)
. = ( 0xf7a9b - code32flat_start ) ;
*16.*(.text.memset)
. = ( 0xf7aaa - code32flat_start ) ;
*16.*(.text.enqueue_key)
. = ( 0xf7b02 - code32flat_start ) ;
*16.*(.text.kbd_set_flag)
. = ( 0xf7b61 - code32flat_start ) ;
*16.*(.text.handle_1524XX)
. = ( 0xf7b6d - code32flat_start ) ;
*16.*(.text.cursor_pos_row)
. = ( 0xf7b7e - code32flat_start ) ;
*16.*(.text.irqtimer_check)
. = ( 0xf7bb7 - code32flat_start ) ;
*16.*(.text.ehci_reset_pipe)
. = ( 0xf7bfc - code32flat_start ) ;
*16.*(.text.lba2chs)
. = ( 0xf7c40 - code32flat_start ) ;
*16.*(.text.scsi_fill_cmd)
. = ( 0xf7cb7 - code32flat_start ) ;
*16.*(.text.on_extra_stack)
. = ( 0xf7cdb - code32flat_start ) ;
*16.*(.text.__stack_hop_back)
. = ( 0xf7d3d - code32flat_start ) ;
*16.*(.text.default_process_op.isra.8)
. = ( 0xf7d5e - code32flat_start ) ;
*16.*(.text.getLCHS)
. = ( 0xf7e05 - code32flat_start ) ;
*16.*(.text.disk_1308)
. = ( 0xf7f3f - code32flat_start ) ;
*16.*(.text.getComAddr)
. = ( 0xf7f71 - code32flat_start ) ;
*16.*(.text.getLptAddr)
. = ( 0xf7fa4 - code32flat_start ) ;
*16.*(.text.clear_usertimer)
. = ( 0xf7fe5 - code32flat_start ) ;
*16.*(.text.call32_post)
. = ( 0xf807d - code32flat_start ) ;
*16.*(.text.floppy_dor_mask)
. = ( 0xf80a0 - code32flat_start ) ;
*16.*(.text.floppy_disable_controller)
. = ( 0xf80ac - code32flat_start ) ;
*16.*(.text.pci_next)
. = ( 0xf813f - code32flat_start ) ;
*16.*(.text.putuint.isra.50)
. = ( 0xf817f - code32flat_start ) ;
*16.*(.text.bvprintf.isra.52)
. = ( 0xf82c2 - code32flat_start ) ;
*16.*(.text.__dprintf)
. = ( 0xf82d6 - code32flat_start ) ;
*16.*(.text.dump_regs)
. = ( 0xf836d - code32flat_start ) ;
*16.*(.text.__warn_timeout)
. = ( 0xf8383 - code32flat_start ) ;
*16.*(.text.timer_calc)
. = ( 0xf839f - code32flat_start ) ;
*16.*(.text.timer_check)
. = ( 0xf83bb - code32flat_start ) ;
*16.*(.text.udelay)
. = ( 0xf8403 - code32flat_start ) ;
*16.*(.text.__i8042_command)
. = ( 0xf8453 - code32flat_start ) ;
*16.*(.text.ndelay.constprop.89)
. = ( 0xf8495 - code32flat_start ) ;
*16.*(.text.fill_generic_edd)
. = ( 0xf8804 - code32flat_start ) ;
*16.*(.text.handle_12)
. = ( 0xf8817 - code32flat_start ) ;
*16.*(.text.handle_11)
. = ( 0xf882a - code32flat_start ) ;
*16.*(.text.handle_05)
. = ( 0xf8850 - code32flat_start ) ;
*16.*(.text.handle_02)
. = ( 0xf8864 - code32flat_start ) ;
*16.*(.text.call16_helper)
. = ( 0xf88a4 - code32flat_start ) ;
*16.*(.text.__call32)
. = ( 0xf890f - code32flat_start ) ;
*16.*(.text.__call32_params.constprop.98)
. = ( 0xf8957 - code32flat_start ) ;
*16.*(.text.usb_poll_intr)
. = ( 0xf8cb0 - code32flat_start ) ;
*16.*(.text._farcall16)
. = ( 0xf8cfb - code32flat_start ) ;
*16.*(.text.__call16_int)
. = ( 0xf8d0e - code32flat_start ) ;
*16.*(.text.handle_75)
. = ( 0xf8d64 - code32flat_start ) ;
*16.*(.text.disk_1346.isra.63)
. = ( 0xf8dfe - code32flat_start ) ;
*16.*(.text.process_key)
. = ( 0xf91f0 - code32flat_start ) ;
*16.*(.text.prockeys)
. = ( 0xf9267 - code32flat_start ) ;
*16.*(.text.ramdisk_copy)
. = ( 0xf93e0 - code32flat_start ) ;
*16.*(.text.check_irqs)
. = ( 0xf9402 - code32flat_start ) ;
*16.*(.text.sercon_putchar)
. = ( 0xf946d - code32flat_start ) ;
*16.*(.text.sercon_term_cursor_goto)
. = ( 0xf9518 - code32flat_start ) ;
*16.*(.text.sercon_set_attr)
. = ( 0xf960d - code32flat_start ) ;
*16.*(.text.sercon_lazy_flush)
. = ( 0xf9734 - code32flat_start ) ;
*16.*(.text.msleep)
. = ( 0xf9759 - code32flat_start ) ;
*16.*(.text.rtc_updating)
. = ( 0xf97a6 - code32flat_start ) ;
*16.*(.text.ps2_recvbyte)
. = ( 0xf985a - code32flat_start ) ;
*16.*(.text.ps2_sendbyte)
. = ( 0xf98d5 - code32flat_start ) ;
*16.*(.text.mouse_command)
. = ( 0xf99aa - code32flat_start ) ;
*16.*(.text.mouse_15c201)
. = ( 0xf99f5 - code32flat_start ) ;
*16.*(.text.handle_160a)
. = ( 0xf9a53 - code32flat_start ) ;
*16.*(.text.uhci_waittick)
. = ( 0xf9aaf - code32flat_start ) ;
*16.*(.text.uhci_send_pipe.constprop.93)
. = ( 0xf9e6c - code32flat_start ) ;
*16.*(.text.ehci_send_pipe.constprop.94)
. = ( 0xfa162 - code32flat_start ) ;
*16.*(.text.usb_send_pipe.constprop.92)
. = ( 0xfa19b - code32flat_start ) ;
*16.*(.text.usb_process_op)
. = ( 0xfa32c - code32flat_start ) ;
*16.*(.text.uas_process_op)
. = ( 0xfa545 - code32flat_start ) ;
*16.*(.text.floppy_wait_irq)
. = ( 0xfa5c2 - code32flat_start ) ;
*16.*(.text.floppy_pio)
. = ( 0xfa70b - code32flat_start ) ;
*16.*(.text.await_ide.constprop.91)
. = ( 0xfa77a - code32flat_start ) ;
*16.*(.text.await_not_bsy)
. = ( 0xfa78a - code32flat_start ) ;
*16.*(.text.ata_pio_transfer)
. = ( 0xfa8bd - code32flat_start ) ;
*16.*(.text.ata_wait_data)
. = ( 0xfa8f6 - code32flat_start ) ;
*16.*(.text.ata_readwrite)
. = ( 0xfaa76 - code32flat_start ) ;
*16.*(.text.ata_atapi_process_op)
. = ( 0xfac09 - code32flat_start ) ;
*16.*(.text.floppy_enable_controller)
. = ( 0xfac9c - code32flat_start ) ;
*16.*(.text.floppy_drive_pio)
. = ( 0xfad6a - code32flat_start ) ;
*16.*(.text.floppy_dma_cmd)
. = ( 0xfaea0 - code32flat_start ) ;
*16.*(.text.floppy_drive_readid.constprop.88)
. = ( 0xfaee6 - code32flat_start ) ;
*16.*(.text.floppy_read)
. = ( 0xfaf9f - code32flat_start ) ;
*16.*(.text.floppy_write)
. = ( 0xfb058 - code32flat_start ) ;
*16.*(.text.floppy_format)
. = ( 0xfb0e5 - code32flat_start ) ;
*16.*(.text.process_op)
. = ( 0xfb468 - code32flat_start ) ;
*16.*(.text.cdemu_read)
. = ( 0xfb691 - code32flat_start ) ;
*16.*(.text.disk_1300)
. = ( 0xfb6cd - code32flat_start ) ;
*16.*(.text.basic_access)
. = ( 0xfb7f5 - code32flat_start ) ;
*16.*(.text.disk_1305)
. = ( 0xfb8f2 - code32flat_start ) ;
*16.*(.text.disk_1310)
. = ( 0xfb931 - code32flat_start ) ;
*16.*(.text.extended_access)
. = ( 0xfba02 - code32flat_start ) ;
*16.*(.text.disk_13)
. = ( 0xfbd2d - code32flat_start ) ;
*16.*(.text.wait_irq)
. = ( 0xfbd4d - code32flat_start ) ;
*16.*(.text.handle_1553)
. = ( 0xfbeb0 - code32flat_start ) ;
*16.*(.text.handle_40)
. = ( 0xfbee2 - code32flat_start ) ;
*16.*(.text.handle_13)
. = ( 0xfbf89 - code32flat_start ) ;
*16.*(.text.handle_76)
. = ( 0xfbf9a - code32flat_start ) ;
*16.*(.text.invoke_mouse_handler)
. = ( 0xfc00d - code32flat_start ) ;
*16.*(.text.process_mouse)
. = ( 0xfc064 - code32flat_start ) ;
*16.*(.text.handle_16)
. = ( 0xfc15b - code32flat_start ) ;
*16.*(.text.handle_1589)
. = ( 0xfc1f5 - code32flat_start ) ;
*16.*(.text.handle_15)
. = ( 0xfc94e - code32flat_start ) ;
*16.*(.text.handle_70)
. = ( 0xfca40 - code32flat_start ) ;
*16.*(.text.handle_resume)
. = ( 0xfcb0b - code32flat_start ) ;
*16.*(.text.handle_pnp)
. = ( 0xfcb54 - code32flat_start ) ;
*16.*(.text.handle_pcibios)
. = ( 0xfcec8 - code32flat_start ) ;
*16.*(.text.handle_74)
. = ( 0xfcf03 - code32flat_start ) ;
*16.*(.text.handle_09)
. = ( 0xfcf4c - code32flat_start ) ;
*16.*(.text.handle_0e)
. = ( 0xfcf66 - code32flat_start ) ;
*16.*(.text.asm.transition32)
. = ( 0xfcfb4 - code32flat_start ) ;
*16.*(.text.asm.transition16)
. = ( 0xfd002 - code32flat_start ) ;
*16.*(.text.asm.__farcall16)
. = ( 0xfd08f - code32flat_start ) ;
*16.*(.text.asm.irq_trampoline_0x02)
. = ( 0xfd092 - code32flat_start ) ;
*16.*(.text.asm.irq_trampoline_0x05)
. = ( 0xfd095 - code32flat_start ) ;
*16.*(.text.asm.irq_trampoline_0x10)
. = ( 0xfd098 - code32flat_start ) ;
*16.*(.text.asm.irq_trampoline_0x13)
. = ( 0xfd09b - code32flat_start ) ;
*16.*(.text.asm.irq_trampoline_0x15)
. = ( 0xfd09e - code32flat_start ) ;
*16.*(.text.asm.irq_trampoline_0x16)
. = ( 0xfd0a1 - code32flat_start ) ;
*16.*(.text.asm.irq_trampoline_0x18)
. = ( 0xfd0a4 - code32flat_start ) ;
*16.*(.text.asm.irq_trampoline_0x19)
. = ( 0xfd0a7 - code32flat_start ) ;
*16.*(.text.asm.entry_resume)
. = ( 0xfd0bc - code32flat_start ) ;
*16.*(.text.asm.entry_pmm)
. = ( 0xfd11a - code32flat_start ) ;
*16.*(.text.asm.entry_pnp_real)
. = ( 0xfd162 - code32flat_start ) ;
*16.*(.text.asm.entry_apm16)
. = ( 0xfd1a3 - code32flat_start ) ;
*16.*(.text.asm.entry_apm32)
. = ( 0xfd1d5 - code32flat_start ) ;
*16.*(.text.asm.entry_pcibios32)
. = ( 0xfd203 - code32flat_start ) ;
*16.*(.text.asm.entry_pcibios16)
. = ( 0xfd23d - code32flat_start ) ;
*16.*(.text.asm.entry_1589)
. = ( 0xfd277 - code32flat_start ) ;
*16.*(.text.asm.entry_csm)
. = ( 0xfd2ae - code32flat_start ) ;
*16.*(.text.asm.__csm_return)
. = ( 0xfd2e2 - code32flat_start ) ;
*16.*(.text.asm.irqentry_extrastack)
. = ( 0xfd36f - code32flat_start ) ;
*16.*(.text.asm.irqentry_arg_extrastack)
. = ( 0xfd411 - code32flat_start ) ;
*16.*(.text.asm.entry_13)
. = ( 0xfd41a - code32flat_start ) ;
*16.*(.text.asm.entry_76)
. = ( 0xfd423 - code32flat_start ) ;
*16.*(.text.asm.entry_70)
. = ( 0xfd42c - code32flat_start ) ;
*16.*(.text.asm.entry_74)
. = ( 0xfd435 - code32flat_start ) ;
*16.*(.text.asm.entry_75)
. = ( 0xfd43e - code32flat_start ) ;
*16.*(.text.asm.entry_hwpic1)
. = ( 0xfd447 - code32flat_start ) ;
*16.*(.text.asm.entry_19)
. = ( 0xfd45a - code32flat_start ) ;
*16.*(.text.asm.entry_18)
. = ( 0xfd46d - code32flat_start ) ;
_rodata16 = . ;
*16.*(.rodata)
. = ( 0xfd8b0 - code32flat_start ) ;
*16.*(.rodata.__func__.12491)
. = ( 0xfd8c4 - code32flat_start ) ;
*16.*(.rodata.__func__.11707)
. = ( 0xfd8d0 - code32flat_start ) ;
*16.*(.rodata.__func__.11665)
. = ( 0xfd8dc - code32flat_start ) ;
*16.*(.rodata.__func__.11339)
. = ( 0xfd8e8 - code32flat_start ) ;
*16.*(.rodata.__func__.11319)
. = ( 0xfd8f8 - code32flat_start ) ;
*16.*(.rodata.__func__.10271)
. = ( 0xfd908 - code32flat_start ) ;
*16.*(.rodata.__func__.10349)
. = ( 0xfd918 - code32flat_start ) ;
*16.*(.rodata.__func__.8758)
. = ( 0xfd924 - code32flat_start ) ;
*16.*(.rodata.__func__.8851)
. = ( 0xfd92c - code32flat_start ) ;
*16.*(.rodata.__func__.8631)
. = ( 0xfd93c - code32flat_start ) ;
*16.*(.rodata.__func__.7752)
. = ( 0xfd94c - code32flat_start ) ;
*16.*(.rodata.__func__.7700)
. = ( 0xfd960 - code32flat_start ) ;
*16.*(.rodata.__func__.4488)
. = ( 0xfd96c - code32flat_start ) ;
*16.*(.rodata.__func__.4843)
. = ( 0xfd978 - code32flat_start ) ;
*16.*(.rodata.__func__.1841)
. = ( 0xfd984 - code32flat_start ) ;
*16.*(.rodata.__func__.1828)
. = ( 0xfd990 - code32flat_start ) ;
*16.*(.rodata.__func__.1824)
. = ( 0xfd99c - code32flat_start ) ;
*16.*(.data16../src/hw/usb-hid.c.159)
. = ( 0xfd9c0 - code32flat_start ) ;
*16.*(.data16../src/hw/usb-hid.c.142)
. = ( 0xfdaa0 - code32flat_start ) ;
*16.*(.data16../src/cp437.c.9)
. = ( 0xfdca0 - code32flat_start ) ;
*16.*(.data16../src/sercon.c.554)
. = ( 0xfdd50 - code32flat_start ) ;
*16.*(.data16../src/sercon.c.70)
. = ( 0xfdd58 - code32flat_start ) ;
*16.*(.data16../src/kbd.c.374)
. = ( 0xfdd60 - code32flat_start ) ;
*16.*(.data16../src/kbd.c.371)
. = ( 0xfdd80 - code32flat_start ) ;
*16.*(.data16../src/kbd.c.279)
. = ( 0xfe048 - code32flat_start ) ;
*16.*(.data16../src/mouse.c.106)
. = ( 0xfe05b - code32flat_start ) ;
*16.*(.fixedaddr.0xe05b)
. = ( 0xfe079 - code32flat_start ) ;
*16.*(.text.fill_edd)
. = ( 0xfe2ac - code32flat_start ) ;
*16.*(.text.unlikely.panic.constprop.97)
. = ( 0xfe2c3 - code32flat_start ) ;
*16.*(.fixedaddr.0xe2c3)
. = ( 0xfe2e8 - code32flat_start ) ;
*16.*(.text.send_cmd)
. = ( 0xfe3fe - code32flat_start ) ;
*16.*(.fixedaddr.0xe3fe)
. = ( 0xfe401 - code32flat_start ) ;
*32flat.*(.fixedaddr.0xe401)
. = ( 0xfe411 - code32flat_start ) ;
*16.*(.text.__ps2_command)
. = ( 0xfe689 - code32flat_start ) ;
*16.*(.text.disk_1315)
. = ( 0xfe6eb - code32flat_start ) ;
*16.*(.text.handle_hwpic1)
. = ( 0xfe6f2 - code32flat_start ) ;
*16.*(.fixedaddr.0xe6f2)
. = ( 0xfe6f5 - code32flat_start ) ;
*32flat.*(.fixedaddr.0xe6f5)
. = ( 0xfe6ff - code32flat_start ) ;
*16.*(.text.__disk_ret_unimplemented.isra.10)
. = ( 0xfe729 - code32flat_start ) ;
*32flat.*(.fixedaddr.0xe729)
. = ( 0xfe739 - code32flat_start ) ;
*16.*(.fixedaddr.0xe739)
. = ( 0xfe742 - code32flat_start ) ;
*16.*(.text.dequeue_key)
. = ( 0xfe826 - code32flat_start ) ;
*16.*(.text.pic_eoi2)
. = ( 0xfe82e - code32flat_start ) ;
*16.*(.fixedaddr.0xe82e)
. = ( 0xfe837 - code32flat_start ) ;
*16.*(.text.handle_17)
. = ( 0xfe987 - code32flat_start ) ;
*16.*(.fixedaddr.0xe987)
. = ( 0xfe990 - code32flat_start ) ;
*16.*(.text.floppy_prep)
. = ( 0xfec4e - code32flat_start ) ;
*16.*(.text.asm.entry_hwpic2)
. = ( 0xfec59 - code32flat_start ) ;
*16.*(.fixedaddr.0xec59)
. = ( 0xfec62 - code32flat_start ) ;
*16.*(.text.handle_1a)
. = ( 0xfeed2 - code32flat_start ) ;
*16.*(.text.handle_legacy_disk)
. = ( 0xfef57 - code32flat_start ) ;
*16.*(.fixedaddr.0xef57)
. = ( 0xfef60 - code32flat_start ) ;
*16.*(.text.sercon_print_utf8)
. = ( 0xfefc7 - code32flat_start ) ;
*32flat.*(.fixedaddr.0xefc7)
. = ( 0xfefd2 - code32flat_start ) ;
*16.*(.fixedaddr.0xefd2)
. = ( 0xfefdb - code32flat_start ) ;
*16.*(.text.set_leds)
. = ( 0xff041 - code32flat_start ) ;
*16.*(.text.asm.irq_trampoline_0x4a)
. = ( 0xff045 - code32flat_start ) ;
*16.*(.fixedaddr.0xf045)
. = ( 0xff046 - code32flat_start ) ;
*16.*(.text.asm.entry_bios32)
. = ( 0xff065 - code32flat_start ) ;
*16.*(.fixedaddr.0xf065)
. = ( 0xff066 - code32flat_start ) ;
*16.*(.text.i8042_wait_write)
. = ( 0xff0a4 - code32flat_start ) ;
*32flat.*(.fixedaddr.0xf0a4)
. = ( 0xff0fc - code32flat_start ) ;
*16.*(.text.handle_08)
. = ( 0xff550 - code32flat_start ) ;
*16.*(.text.megasas_process_op)
. = ( 0xff7b7 - code32flat_start ) ;
*16.*(.text.set_usertimer)
. = ( 0xff83a - code32flat_start ) ;
*16.*(.text.asm.irq_trampoline_0x1c)
. = ( 0xff83d - code32flat_start ) ;
*16.*(.text.asm.irq_trampoline_0x1b)
. = ( 0xff841 - code32flat_start ) ;
*16.*(.fixedaddr.0xf841)
. = ( 0xff84a - code32flat_start ) ;
*16.*(.text.handle_hwpic2)
. = ( 0xff84d - code32flat_start ) ;
*16.*(.fixedaddr.0xf84d)
. = ( 0xff856 - code32flat_start ) ;
*16.*(.text.handle_apm)
. = ( 0xff859 - code32flat_start ) ;
*16.*(.fixedaddr.0xf859)
. = ( 0xff869 - code32flat_start ) ;
*16.*(.text.handle_14)
. = ( 0xffa3e - code32flat_start ) ;
*16.*(.text.__disk_ret.isra.9)
. = ( 0xffa6e - code32flat_start ) ;
*32flat.*(.fixedaddr.0xfa6e)
. = ( 0xffe6e - code32flat_start ) ;
*16.*(.fixedaddr.0xfe6e)
. = ( 0xffe7e - code32flat_start ) ;
*16.*(.text.rtc_setup)
. = ( 0xffea5 - code32flat_start ) ;
*16.*(.fixedaddr.0xfea5)
. = ( 0xffeae - code32flat_start ) ;
*16.*(.text.shiftbuf)
. = ( 0xffef3 - code32flat_start ) ;
*32flat.*(.fixedaddr.0xfef3)
. = ( 0xfff00 - code32flat_start ) ;
*16.*(.text.procmodkey)
. = ( 0xfff53 - code32flat_start ) ;
*16.*(.fixedaddr.0xff53)
. = ( 0xfff54 - code32flat_start ) ;
*16.*(.fixedaddr.0xff54)
. = ( 0xfff5d - code32flat_start ) ;
*16.*(.text.timer_read)
. = ( 0xffff0 - code32flat_start ) ;
*16.*(.fixedaddr.0xfff0)
. = ( 0xffff5 - code32flat_start ) ;
*32flat.*(.fixedaddr.0xfff5)
. = ( 0xffffe - code32flat_start ) ;
*32flat.*(.fixedaddr.0xfffe)
. = ( 0xfffff - code32flat_start ) ;
*32flat.*(.fixedaddr.0xffff)

        code32flat_end = ABSOLUTE(.) ;
    } :text


        /* Discard regular data sections to force a link error if
         * code attempts to access data not marked with VAR16 (or other
         * appropriate macro)
         */
        /DISCARD/ : {
                *(.text*) *(.data*) *(.bss*) *(.rodata*)
                *(COMMON) *(.discard*) *(.eh_frame) *(.note*)
                }
}

ENTRY(entry_csm)
PHDRS
{
        text PT_LOAD AT ( code32flat_start ) ;
}
