
/* DO NOT EDIT!  This is an autogenerated file.  See scripts/layoutrom.py. */
OUTPUT_FORMAT("elf32-i386")
OUTPUT_ARCH("i386")
SECTIONS
{
_cfunc32flat_tpm_interrupt_handler32 = 0xf49c4 ;
e820_list = 0x6e80 ;
sercon_char = 0xf799 ;
_cfunc16_check_irqs = 0x93e0 ;
rx_buf = 0xf788 ;
_cfunc32flat_call32_params_helper = 0xf3c6a ;
MaxPCIBus = 0x6e44 ;
IntelDisplayType = 0x7192 ;
_cfunc32flat_handle_pmm = 0xefdb9 ;
ViaFBsize = 0x7198 ;
e820_count = 0x6e64 ;
TimerKHz = 0x7178 ;
LegacyRamSize = 0x6e60 ;
ViaRamSpeed = 0x7194 ;
CDRom_locks = 0xf7a0 ;
acpi_pm1a_cnt = 0x6da0 ;
sercon_attr = 0xf798 ;
FloppyInfo = 0x7100 ;
sercon_row_last = 0xf79a ;
_cfunc32flat_handle_resume32 = 0xf46f3 ;
emulated_drive_gf = 0xf7b0 ;
_cfunc32flat_xhci_poll_intr = 0xf4cfe ;
_cfunc32flat_process_op_32 = 0xf3c7a ;
_cfunc16_invoke_mouse_handler = 0xbf9a ;
mouse_pipe = 0x716c ;
bounce_buf_fl = 0x71c8 ;
StackPos = 0xf7d8 ;
DefaultDPTE = 0xf7c8 ;
sercon_col_last = 0xf79b ;
CanPreempt = 0x72a4 ;
VGAHookHandlerType = 0x719c ;
_cfunc32flat_handle_post = 0xf496a ;
_cfunc32seg_handle_pcibios = 0x7512 ;
sercon_attr_last = 0xf79c ;
FloppyCount = 0x72a0 ;
ShiftTSC = 0x7174 ;
_cfunc16_wait_irq = 0xbd2d ;
IDMap = 0x71e0 ;
Call16Data = 0xffe4 ;
MainThread = 0x72a8 ;
pmode_IDT_info = 0x72f8 ;
PirAddr = 0x6da4 ;
_cfunc32flat_handle_19 = 0xf4997 ;
SmiBootDisplay = 0x7190 ;
CDEmu = 0xf7b4 ;
LastUSBkey = 0xf770 ;
keyboard_pipe = 0x7170 ;
_cfunc32seg_handle_apm = 0x783d ;
rombios32_gdt_48 = 0x72b4 ;
HaveRunPost = 0x7308 ;
_cfunc32flat_handle_csm = 0xeff49 ;
_cfunc32flat_yield_preempt = 0xeed22 ;
rx_bytes = 0xf785 ;
Century = 0xf784 ;
ExtraStack = 0xf7e0 ;
diskette_param_table2 = 0x715c ;
rmode_IDT_info = 0x7300 ;
_cfunc32flat_handle_18 = 0xf496b ;
TimerPort = 0x7176 ;
_cfunc16__farcall16 = 0x8cb0 ;
Ps2ctr = 0xf778 ;
FloppyDOR = 0xf76c ;
BIOS_CONFIG_TABLE = 0xe6f5 ;
RTCusers = 0xf77c ;
cdemu_drive_gf = 0x71c4 ;
IntelDisplayId = 0x7191 ;
TimerLast = 0xf780 ;
sercon_port = 0xf79e ;

    zonelow_base = 0xe0000 ;
    _zonelow_seg = 0xe000 ;

.text.set_a20 0x79e0 : { *(.text.set_a20) }
.text.set_code_success 0x7a00 : { *(.text.set_code_success) }
.text.pic_eoi2 0xe826 : { *(.text.pic_eoi2) }
.text.call32_prep 0x7a0c : { *(.text.call32_prep) }
.text.memset 0x7a9b : { *(.text.memset) }
.text.enqueue_key 0x7aaa : { *(.text.enqueue_key) }
.text.kbd_set_flag 0x7b02 : { *(.text.kbd_set_flag) }
.text.handle_1524XX 0x7b61 : { *(.text.handle_1524XX) }
.text.cursor_pos_row 0x7b6d : { *(.text.cursor_pos_row) }
.text.shiftbuf 0xfeae : { *(.text.shiftbuf) }
.text.irqtimer_check 0x7b7e : { *(.text.irqtimer_check) }
.text.ehci_reset_pipe 0x7bb7 : { *(.text.ehci_reset_pipe) }
.text.lba2chs 0x7bfc : { *(.text.lba2chs) }
.text.scsi_fill_cmd 0x7c40 : { *(.text.scsi_fill_cmd) }
.text.on_extra_stack 0x7cb7 : { *(.text.on_extra_stack) }
.text.__stack_hop_back 0x7cdb : { *(.text.__stack_hop_back) }
.text.default_process_op.isra.8 0x7d3d : { *(.text.default_process_op.isra.8) }
.text.__disk_ret.isra.9 0xfa3e : { *(.text.__disk_ret.isra.9) }
.text.__disk_ret_unimplemented.isra.10 0xe6ff : { *(.text.__disk_ret_unimplemented.isra.10) }
.text.getLCHS 0x7d5e : { *(.text.getLCHS) }
.text.disk_1308 0x7e05 : { *(.text.disk_1308) }
.text.disk_1315 0xe689 : { *(.text.disk_1315) }
.text.getComAddr 0x7f3f : { *(.text.getComAddr) }
.text.getLptAddr 0x7f71 : { *(.text.getLptAddr) }
.text.clear_usertimer 0x7fa4 : { *(.text.clear_usertimer) }
.text.call32_post 0x7fe5 : { *(.text.call32_post) }
.text.floppy_dor_mask 0x807d : { *(.text.floppy_dor_mask) }
.text.floppy_disable_controller 0x80a0 : { *(.text.floppy_disable_controller) }
.text.pci_next 0x80ac : { *(.text.pci_next) }
.text.rtc_setup 0xfe7e : { *(.text.rtc_setup) }
.text.putuint.isra.50 0x813f : { *(.text.putuint.isra.50) }
.text.bvprintf.isra.52 0x817f : { *(.text.bvprintf.isra.52) }
.text.__dprintf 0x82c2 : { *(.text.__dprintf) }
.text.dump_regs 0x82d6 : { *(.text.dump_regs) }
.text.__warn_timeout 0x836d : { *(.text.__warn_timeout) }
.text.unlikely.panic.constprop.97 0xe2ac : { *(.text.unlikely.panic.constprop.97) }
.text.set_usertimer 0xf7b7 : { *(.text.set_usertimer) }
.text.timer_read 0xff5d : { *(.text.timer_read) }
.text.timer_calc 0x8383 : { *(.text.timer_calc) }
.text.timer_check 0x839f : { *(.text.timer_check) }
.text.udelay 0x83bb : { *(.text.udelay) }
.text.i8042_wait_write 0xf066 : { *(.text.i8042_wait_write) }
.text.__i8042_command 0x8403 : { *(.text.__i8042_command) }
.text.ndelay.constprop.89 0x8453 : { *(.text.ndelay.constprop.89) }
.text.fill_generic_edd 0x8495 : { *(.text.fill_generic_edd) }
.text.fill_edd 0xe079 : { *(.text.fill_edd) }
.text.handle_12 0x8804 : { *(.text.handle_12) }
.text.handle_11 0x8817 : { *(.text.handle_11) }
.text.handle_05 0x882a : { *(.text.handle_05) }
.text.handle_02 0x8850 : { *(.text.handle_02) }
.text.call16_helper 0x8864 : { *(.text.call16_helper) }
.text.__call32 0x88a4 : { *(.text.__call32) }
.text.__call32_params.constprop.98 0x890f : { *(.text.__call32_params.constprop.98) }
.text.usb_poll_intr 0x8957 : { *(.text.usb_poll_intr) }
.text._farcall16 0x8cb0 : { *(.text._farcall16) }
.text.__call16_int 0x8cfb : { *(.text.__call16_int) }
.text.handle_75 0x8d0e : { *(.text.handle_75) }
.text.disk_1346.isra.63 0x8d64 : { *(.text.disk_1346.isra.63) }
.text.process_key 0x8dfe : { *(.text.process_key) }
.text.prockeys 0x91f0 : { *(.text.prockeys) }
.text.procmodkey 0xff00 : { *(.text.procmodkey) }
.text.ramdisk_copy 0x9267 : { *(.text.ramdisk_copy) }
.text.check_irqs 0x93e0 : { *(.text.check_irqs) }
.text.sercon_putchar 0x9402 : { *(.text.sercon_putchar) }
.text.sercon_print_utf8 0xef60 : { *(.text.sercon_print_utf8) }
.text.sercon_term_cursor_goto 0x946d : { *(.text.sercon_term_cursor_goto) }
.text.sercon_set_attr 0x9518 : { *(.text.sercon_set_attr) }
.text.sercon_lazy_flush 0x960d : { *(.text.sercon_lazy_flush) }
.text.msleep 0x9734 : { *(.text.msleep) }
.text.rtc_updating 0x9759 : { *(.text.rtc_updating) }
.text.ps2_recvbyte 0x97a6 : { *(.text.ps2_recvbyte) }
.text.ps2_sendbyte 0x985a : { *(.text.ps2_sendbyte) }
.text.__ps2_command 0xe411 : { *(.text.__ps2_command) }
.text.set_leds 0xefdb : { *(.text.set_leds) }
.text.mouse_command 0x98d5 : { *(.text.mouse_command) }
.text.mouse_15c201 0x99aa : { *(.text.mouse_15c201) }
.text.handle_160a 0x99f5 : { *(.text.handle_160a) }
.text.uhci_waittick 0x9a53 : { *(.text.uhci_waittick) }
.text.uhci_send_pipe.constprop.93 0x9aaf : { *(.text.uhci_send_pipe.constprop.93) }
.text.ehci_send_pipe.constprop.94 0x9e6c : { *(.text.ehci_send_pipe.constprop.94) }
.text.usb_send_pipe.constprop.92 0xa162 : { *(.text.usb_send_pipe.constprop.92) }
.text.usb_process_op 0xa19b : { *(.text.usb_process_op) }
.text.uas_process_op 0xa32c : { *(.text.uas_process_op) }
.text.floppy_wait_irq 0xa545 : { *(.text.floppy_wait_irq) }
.text.floppy_pio 0xa5c2 : { *(.text.floppy_pio) }
.text.megasas_process_op 0xf550 : { *(.text.megasas_process_op) }
.text.await_ide.constprop.91 0xa70b : { *(.text.await_ide.constprop.91) }
.text.await_not_bsy 0xa77a : { *(.text.await_not_bsy) }
.text.send_cmd 0xe2e8 : { *(.text.send_cmd) }
.text.ata_pio_transfer 0xa78a : { *(.text.ata_pio_transfer) }
.text.ata_wait_data 0xa8bd : { *(.text.ata_wait_data) }
.text.ata_readwrite 0xa8f6 : { *(.text.ata_readwrite) }
.text.ata_atapi_process_op 0xaa76 : { *(.text.ata_atapi_process_op) }
.text.floppy_enable_controller 0xac09 : { *(.text.floppy_enable_controller) }
.text.floppy_drive_pio 0xac9c : { *(.text.floppy_drive_pio) }
.text.floppy_dma_cmd 0xad6a : { *(.text.floppy_dma_cmd) }
.text.floppy_drive_readid.constprop.88 0xaea0 : { *(.text.floppy_drive_readid.constprop.88) }
.text.floppy_prep 0xe990 : { *(.text.floppy_prep) }
.text.floppy_read 0xaee6 : { *(.text.floppy_read) }
.text.floppy_write 0xaf9f : { *(.text.floppy_write) }
.text.floppy_format 0xb058 : { *(.text.floppy_format) }
.text.process_op 0xb0e5 : { *(.text.process_op) }
.text.cdemu_read 0xb468 : { *(.text.cdemu_read) }
.text.disk_1300 0xb691 : { *(.text.disk_1300) }
.text.basic_access 0xb6cd : { *(.text.basic_access) }
.text.disk_1305 0xb7f5 : { *(.text.disk_1305) }
.text.disk_1310 0xb8f2 : { *(.text.disk_1310) }
.text.extended_access 0xb931 : { *(.text.extended_access) }
.text.disk_13 0xba02 : { *(.text.disk_13) }
.text.handle_legacy_disk 0xeed2 : { *(.text.handle_legacy_disk) }
.text.wait_irq 0xbd2d : { *(.text.wait_irq) }
.text.dequeue_key 0xe742 : { *(.text.dequeue_key) }
.text.handle_1553 0xbd4d : { *(.text.handle_1553) }
.text.handle_40 0xbeb0 : { *(.text.handle_40) }
.text.handle_13 0xbee2 : { *(.text.handle_13) }
.text.handle_76 0xbf89 : { *(.text.handle_76) }
.text.invoke_mouse_handler 0xbf9a : { *(.text.invoke_mouse_handler) }
.text.process_mouse 0xc00d : { *(.text.process_mouse) }
.text.handle_16 0xc064 : { *(.text.handle_16) }
.text.handle_1589 0xc15b : { *(.text.handle_1589) }
.text.handle_15 0xc1f5 : { *(.text.handle_15) }
.text.handle_14 0xf869 : { *(.text.handle_14) }
.text.handle_17 0xe837 : { *(.text.handle_17) }
.text.handle_1a 0xec62 : { *(.text.handle_1a) }
.text.handle_08 0xf0fc : { *(.text.handle_08) }
.text.handle_70 0xc94e : { *(.text.handle_70) }
.text.handle_resume 0xca40 : { *(.text.handle_resume) }
.text.handle_pnp 0xcb0b : { *(.text.handle_pnp) }
.text.handle_pcibios 0xcb54 : { *(.text.handle_pcibios) }
.text.handle_apm 0xf856 : { *(.text.handle_apm) }
.text.handle_hwpic1 0xe6eb : { *(.text.handle_hwpic1) }
.text.handle_hwpic2 0xf84a : { *(.text.handle_hwpic2) }
.text.handle_74 0xcec8 : { *(.text.handle_74) }
.text.handle_09 0xcf03 : { *(.text.handle_09) }
.text.handle_0e 0xcf4c : { *(.text.handle_0e) }
.text.asm.transition32 0xcf66 : { *(.text.asm.transition32) }
.text.asm.transition16 0xcfb4 : { *(.text.asm.transition16) }
.text.asm.__farcall16 0xd002 : { *(.text.asm.__farcall16) }
.text.asm.irq_trampoline_0x02 0xd08f : { *(.text.asm.irq_trampoline_0x02) }
.text.asm.irq_trampoline_0x05 0xd092 : { *(.text.asm.irq_trampoline_0x05) }
.text.asm.irq_trampoline_0x10 0xd095 : { *(.text.asm.irq_trampoline_0x10) }
.text.asm.irq_trampoline_0x13 0xd098 : { *(.text.asm.irq_trampoline_0x13) }
.text.asm.irq_trampoline_0x15 0xd09b : { *(.text.asm.irq_trampoline_0x15) }
.text.asm.irq_trampoline_0x16 0xd09e : { *(.text.asm.irq_trampoline_0x16) }
.text.asm.irq_trampoline_0x18 0xd0a1 : { *(.text.asm.irq_trampoline_0x18) }
.text.asm.irq_trampoline_0x19 0xd0a4 : { *(.text.asm.irq_trampoline_0x19) }
.text.asm.irq_trampoline_0x1b 0xf83d : { *(.text.asm.irq_trampoline_0x1b) }
.text.asm.irq_trampoline_0x1c 0xf83a : { *(.text.asm.irq_trampoline_0x1c) }
.text.asm.irq_trampoline_0x4a 0xf041 : { *(.text.asm.irq_trampoline_0x4a) }
.text.asm.entry_resume 0xd0a7 : { *(.text.asm.entry_resume) }
.text.asm.entry_pmm 0xd0bc : { *(.text.asm.entry_pmm) }
.text.asm.entry_pnp_real 0xd11a : { *(.text.asm.entry_pnp_real) }
.text.asm.entry_apm16 0xd162 : { *(.text.asm.entry_apm16) }
.text.asm.entry_apm32 0xd1a3 : { *(.text.asm.entry_apm32) }
.text.asm.entry_pcibios32 0xd1d5 : { *(.text.asm.entry_pcibios32) }
.text.asm.entry_pcibios16 0xd203 : { *(.text.asm.entry_pcibios16) }
.text.asm.entry_1589 0xd23d : { *(.text.asm.entry_1589) }
.text.asm.entry_bios32 0xf046 : { *(.text.asm.entry_bios32) }
.text.asm.entry_csm 0xd277 : { *(.text.asm.entry_csm) }
.text.asm.__csm_return 0xd2ae : { *(.text.asm.__csm_return) }
.text.asm.irqentry_extrastack 0xd2e2 : { *(.text.asm.irqentry_extrastack) }
.text.asm.irqentry_arg_extrastack 0xd36f : { *(.text.asm.irqentry_arg_extrastack) }
.text.asm.entry_13 0xd411 : { *(.text.asm.entry_13) }
.text.asm.entry_76 0xd41a : { *(.text.asm.entry_76) }
.text.asm.entry_70 0xd423 : { *(.text.asm.entry_70) }
.text.asm.entry_74 0xd42c : { *(.text.asm.entry_74) }
.text.asm.entry_75 0xd435 : { *(.text.asm.entry_75) }
.text.asm.entry_hwpic1 0xd43e : { *(.text.asm.entry_hwpic1) }
.text.asm.entry_hwpic2 0xec4e : { *(.text.asm.entry_hwpic2) }
.text.asm.entry_19 0xd447 : { *(.text.asm.entry_19) }
.text.asm.entry_18 0xd45a : { *(.text.asm.entry_18) }
.rodata 0xd46d : { *(.rodata) }
.rodata.__func__.12491 0xd8b0 : { *(.rodata.__func__.12491) }
.rodata.__func__.11707 0xd8c4 : { *(.rodata.__func__.11707) }
.rodata.__func__.11665 0xd8d0 : { *(.rodata.__func__.11665) }
.rodata.__func__.11339 0xd8dc : { *(.rodata.__func__.11339) }
.rodata.__func__.11319 0xd8e8 : { *(.rodata.__func__.11319) }
.rodata.__func__.10271 0xd8f8 : { *(.rodata.__func__.10271) }
.rodata.__func__.10349 0xd908 : { *(.rodata.__func__.10349) }
.rodata.__func__.8758 0xd918 : { *(.rodata.__func__.8758) }
.rodata.__func__.8851 0xd924 : { *(.rodata.__func__.8851) }
.rodata.__func__.8631 0xd92c : { *(.rodata.__func__.8631) }
.rodata.__func__.7752 0xd93c : { *(.rodata.__func__.7752) }
.rodata.__func__.7700 0xd94c : { *(.rodata.__func__.7700) }
.rodata.__func__.4488 0xd960 : { *(.rodata.__func__.4488) }
.rodata.__func__.4843 0xd96c : { *(.rodata.__func__.4843) }
.rodata.__func__.1841 0xd978 : { *(.rodata.__func__.1841) }
.rodata.__func__.1828 0xd984 : { *(.rodata.__func__.1828) }
.rodata.__func__.1824 0xd990 : { *(.rodata.__func__.1824) }
.data16../src/hw/usb-hid.c.159 0xd99c : { *(.data16../src/hw/usb-hid.c.159) }
.data16../src/hw/usb-hid.c.142 0xd9c0 : { *(.data16../src/hw/usb-hid.c.142) }
.data16../src/cp437.c.9 0xdaa0 : { *(.data16../src/cp437.c.9) }
.data16../src/sercon.c.554 0xdca0 : { *(.data16../src/sercon.c.554) }
.data16../src/sercon.c.70 0xdd50 : { *(.data16../src/sercon.c.70) }
.data16../src/kbd.c.374 0xdd58 : { *(.data16../src/kbd.c.374) }
.data16../src/kbd.c.371 0xdd60 : { *(.data16../src/kbd.c.371) }
.data16../src/kbd.c.279 0xdd80 : { *(.data16../src/kbd.c.279) }
.data16../src/mouse.c.106 0xe048 : { *(.data16../src/mouse.c.106) }
.fixedaddr.0xe05b 0xe05b : { *(.fixedaddr.0xe05b) }
.fixedaddr.0xe2c3 0xe2c3 : { *(.fixedaddr.0xe2c3) }
.fixedaddr.0xe3fe 0xe3fe : { *(.fixedaddr.0xe3fe) }
.fixedaddr.0xe6f2 0xe6f2 : { *(.fixedaddr.0xe6f2) }
.fixedaddr.0xe739 0xe739 : { *(.fixedaddr.0xe739) }
.fixedaddr.0xe82e 0xe82e : { *(.fixedaddr.0xe82e) }
.fixedaddr.0xe987 0xe987 : { *(.fixedaddr.0xe987) }
.fixedaddr.0xec59 0xec59 : { *(.fixedaddr.0xec59) }
.fixedaddr.0xef57 0xef57 : { *(.fixedaddr.0xef57) }
.fixedaddr.0xefd2 0xefd2 : { *(.fixedaddr.0xefd2) }
.fixedaddr.0xf045 0xf045 : { *(.fixedaddr.0xf045) }
.fixedaddr.0xf065 0xf065 : { *(.fixedaddr.0xf065) }
.fixedaddr.0xf841 0xf841 : { *(.fixedaddr.0xf841) }
.fixedaddr.0xf84d 0xf84d : { *(.fixedaddr.0xf84d) }
.fixedaddr.0xf859 0xf859 : { *(.fixedaddr.0xf859) }
.fixedaddr.0xfe6e 0xfe6e : { *(.fixedaddr.0xfe6e) }
.fixedaddr.0xfea5 0xfea5 : { *(.fixedaddr.0xfea5) }
.fixedaddr.0xff53 0xff53 : { *(.fixedaddr.0xff53) }
.fixedaddr.0xff54 0xff54 : { *(.fixedaddr.0xff54) }
.fixedaddr.0xfff0 0xfff0 : { *(.fixedaddr.0xfff0) }



        /* Discard regular data sections to force a link error if
         * code attempts to access data not marked with VAR16 (or other
         * appropriate macro)
         */
        /DISCARD/ : {
                *(.text*) *(.data*) *(.bss*) *(.rodata*)
                *(COMMON) *(.discard*) *(.eh_frame) *(.note*)
                }
}
